## boards/tricore/tc4xx/a3g-tc4d7-lite/Kconfig
```kconfig
#
# For a description of the syntax of this configuration file,
# see the file kconfig-language.txt in the NuttX tools repository.
#

if ARCH_BOARD_A3G_TC4D7_LITE

config ARCH_HAVE_LEDS
	bool
	default y

config BOARD_TC4D7_BUTTONS
	bool "Enable button support"
	default y
	---help---
		Enable support for the user push button on the
		AURIX TC4D7 Lite board. The button is wired to P03.11
		and is active-low.

config ARCH_BUTTONS
	bool
	default y

config ARCH_IRQBUTTONS
	bool
	default y

config BOARD_PHY_AUTONEG
	bool "Ethernet PHY autonegotiation"
	default y

config BOARD_GPIO_TEST
	bool "Register Port-22 GPIO pins for gpio_test"
	default n
	depends on DEV_GPIO
	---help---
		Registers /dev/gpio0 (P22.0 output, init high), /dev/gpio1
		(P22.2 input pull-up), /dev/gpio2 (P22.3 input pull-down) on
		boot via aurix_gpio_lower_register().  Wire P22.0 to P22.2
		(or P22.3) externally to verify loopback with the gpio_test
		userspace app.

config BOARD_USER_LED_GPIO
	bool "Register on-board user LED1 (P03.9) as /dev/gpio0"
	default n
	depends on DEV_GPIO
	depends on !BOARD_GPIO_TEST
	---help---
		Registers TC4D7-Lite Kit user LED1 (P03.9) as /dev/gpio0
		via aurix_gpio_lower_register().  The pin is configured as
		push-pull output with init level HIGH so the LED is off at
		boot (the kit drives LED1 active-low).  Run the led_blink
		smoke test from tricore-apps to toggle it at 1 Hz.

if TC4XX_EGTM_PWM_LOWERHALF

menu "TC4D7-Lite PWM channels to register"

config TC4D7_PWM_ANY
	bool

config TC4D7_PWM_CH0
	bool "/dev/pwm0  = P00.0  -> TOM0_0  (TOUT9,  sel 0x14)"
	select TC4D7_PWM_ANY

config TC4D7_PWM_CH1
	bool "/dev/pwm1  = P00.1  -> TOM0_1  (TOUT10, sel 0x14)"
	select TC4D7_PWM_ANY

config TC4D7_PWM_CH2
	bool "/dev/pwm2  = P00.2  -> TOM0_2  (TOUT11, sel 0x14)"
	select TC4D7_PWM_ANY

config TC4D7_PWM_CH3
	bool "/dev/pwm3  = P00.3  -> TOM0_3  (TOUT12, sel 0x14)"
	select TC4D7_PWM_ANY

config TC4D7_PWM_CH4
	bool "/dev/pwm4  = P00.4  -> TOM0_11 (TOUT13, sel 0x10)"
	select TC4D7_PWM_ANY

config TC4D7_PWM_CH5
	bool "/dev/pwm5  = P00.5  -> TOM0_12 (TOUT14, sel 0x10)"
	select TC4D7_PWM_ANY

config TC4D7_PWM_CH6
	bool "/dev/pwm6  = P00.6  -> TOM0_13 (TOUT15, sel 0x10)"
	select TC4D7_PWM_ANY

config TC4D7_PWM_CH7
	bool "/dev/pwm7  = P00.7  -> TOM0_14 (TOUT16, sel 0x10)"
	select TC4D7_PWM_ANY

config TC4D7_PWM_CH8
	bool "/dev/pwm8  = P00.8  -> TOM0_15 (TOUT17, sel 0x10)"
	select TC4D7_PWM_ANY

config TC4D7_PWM_CH9
	bool "/dev/pwm9  = P00.9  -> TOM0_9  (TOUT18, sel 0x04)"
	select TC4D7_PWM_ANY

config TC4D7_PWM_CH10
	bool "/dev/pwm10 = P00.11 -> TOM0_10 (TOUT20, sel 0x04)"
	select TC4D7_PWM_ANY

config TC4D7_PWM_CH11
	bool "/dev/pwm11 = P03.3  -> TOM2_9  (TOUT274, sel 0x06) [CLS2]"
	select TC4D7_PWM_ANY

config TC4D7_PWM_CH12
	bool "/dev/pwm12 = P03.4  -> TOM2_10 (TOUT275, sel 0x15) [CLS2]"
	select TC4D7_PWM_ANY

endmenu

endif # TC4XX_EGTM_PWM_LOWERHALF

endif
```

## boards/tricore/tc4xx/a3g-tc4d7-lite/configs/spi_test/defconfig
```kconfig
#
# spi_test: NSH on ASCLIN0 + ASCLIN3-SPI on mikroBUS pins for ENC28J60
# bring-up.  /dev/spi0 = ASCLIN3 (P15.6/15.7/15.8 + P14.7 GPIO CS).
#
# CONFIG_DEV_NULL is not set
# CONFIG_DEV_ZERO is not set
CONFIG_ARCH="tricore"
CONFIG_ARCH_BOARD="a3g-tc4d7-lite"
CONFIG_ARCH_BOARD_A3G_TC4D7_LITE=y
CONFIG_ARCH_CHIP="tc4xx"
CONFIG_ARCH_CHIP_FAMILY_TC4XX=y
CONFIG_ARCH_INTERRUPTSTACK=2048
CONFIG_ARCH_STACKDUMP=y
CONFIG_ARCH_TRICORE=y
CONFIG_ARCH_TRICORE_CPU_COUNT=1
CONFIG_BINFMT_DISABLE=y
CONFIG_BUILTIN=y
CONFIG_DISABLE_ENVIRON=y
CONFIG_DISABLE_MQUEUE=y
CONFIG_DISABLE_POSIX_TIMERS=y
CONFIG_DISABLE_PTHREAD=y
CONFIG_FLASH_SIZE=4194304
CONFIG_FLASH_START=0x80000000
CONFIG_FS_PROCFS=y
CONFIG_INIT_ENTRYNAME="main"
CONFIG_INIT_ENTRYPOINT="nsh_main"
CONFIG_NSH_ARCHINIT=y
CONFIG_NSH_BUILTIN_APPS=y
CONFIG_RAM_SIZE=5242880
CONFIG_RAM_START=0x90400000
CONFIG_RR_INTERVAL=1
CONFIG_SCHED_HPWORK=y
CONFIG_SCHED_HPWORKSTACKSIZE=4096
CONFIG_SYSLOG_CONSOLE=y
CONFIG_SYSTEM_NSH=y
CONFIG_TRICORE_UART0=y
CONFIG_UART0_SERIAL_CONSOLE=y
CONFIG_USEC_PER_TICK=100
CONFIG_SPI=y
CONFIG_SPI_DRIVER=y
CONFIG_SPI_EXCHANGE=y
CONFIG_TC4XX_ASCLIN_SPI=y
CONFIG_TC4XX_ASCLIN3_SPI=y
CONFIG_TC4XX_ASCLIN_SPI_CHARDEV=y
CONFIG_TESTING_SPI_TEST=y
CONFIG_TESTING_ENC28J60_SMOKE=y
CONFIG_DEV_GPIO=y
CONFIG_BOARD_GPIO_TEST=y
CONFIG_TESTING_GPIO_TEST=y
```
