## arch/tricore/src/tc4x/Kconfig
```kconfig
#
# For a description of the syntax of this configuration file,
# see the file kconfig-language.txt in the NuttX tools repository.
#

comment "Infineon AURIX TC4X Chip"

choice
	prompt "Infineon AURIX TC4X Chip selection"
	default TC4X_CHIP_TC4D7

config TC4X_CHIP_TC4D7
	bool "TC4D7 SoC"
	---help---
		Infineon AURIX TC4D7.

config TC4X_CHIP_TC487
	bool "TC487 SoC"
	---help---
		TC487 SoC

config TC4X_CHIP_TC499
	bool "TC499 SoC"
	---help---
		TC499 SoC

endchoice

config ARCH_TRICORE_CPU_COUNT
	int "TRICORE CPU count"
	default 1
	---help---
		Tricore CPU count

config TC4X_PERI_MMAP_OFFSET
	hex "Tricore base address"
	default 0x4400000 if TC4X_CHIP_TC4D7 || TC4X_CHIP_TC487
	default 0 if TC4X_CHIP_TC499

config TRICORE_STM_FREQUENCY
	int "STM clock frequency (Hz)"
	default 400000000 if TC4X_CHIP_TC487
	default 500000000
	---help---
		Frequency of the clock feeding the System Timer.  The tick
		period is derived from it, so a wrong value scales all
		timekeeping.

config TC4X_WDT
	bool "TC4x Watchdog Timer (WTU)"
	default n
	depends on WATCHDOG
	---help---
		Enable the TC4x Watchdog Timer lowerhalf (/dev/watchdogN).
		Supports all 7 WDT instances: CPU0-CPU5 and the System WDT.

		Note: WDT overflow raises an SMU alarm. Producing a system
		reset from that alarm needs SMU configuration (not yet
		supported); without it, overflow defaults to NMI.

config TC4X_WDT_FSPB
	int "SPB clock frequency (Hz)"
	default 100000000
	depends on TC4X_WDT
	---help---
		The SPB (System Peripheral Bus) clock frequency in Hz, used
		to compute WDT timeout periods. TC4x fSPB target is 100 MHz.

config TC4X_SMU
	bool "TC4x Safety Management Unit (SMU_SAFE) driver"
	default n
	---help---
		Enable the SMU_SAFE lower-half driver for the Infineon AURIX
		TC4x family.  The driver operates on SMU_SAFE0 by default;
		SMU_SAFE1 is available through the flat tc4x_smu_* API.

if TC4X_SMU

config TC4X_SMU_SAFE_INST
	int "SMU_SAFE partition to drive (0 = SAFE0, 1 = SAFE1)"
	default 0
	range 0 1
	---help---
		Selects which SMU_SAFE partition the driver operates on for
		hardware init, alarm arming, and the /dev/smu0 upper-half.

config TC4X_SMU_IRQ
	bool "SMU interrupt handler via SRC_SMU_SAFE"
	default n
	---help---
		Route IGCS0/1/2 alarm reactions to SRC_SMU_SAFE outputs and
		attach an ISR, and use the recovery timer as an escalation
		path.

config TC4X_SMU_WDT_REACTION
	int "WDT alarm default reaction code"
	default 2 if TC4X_SMU_IRQ
	default 6
	range 0 7
	---help---
		Reaction code written to WDT alarm bits (AGSF8[10..16])
		during tc4x_smu_initialize().  Individual alarms can be
		reconfigured at runtime via the SMUIOC_CONFIGALARM ioctl.

		  0 = NONE    (no reaction -- WDT overflow silently ignored)
		  2 = IGCS0   (interrupt via SRC_SMU_SAFE, requires TC4X_SMU_IRQ)
		  3 = IGCS1   (interrupt via SRC_SMU_SAFE, requires TC4X_SMU_IRQ)
		  4 = IGCS2   (interrupt via SRC_SMU_SAFE, requires TC4X_SMU_IRQ)
		  6 = RESET   (hardware-autonomous Application Reset, default
		               when TC4X_SMU_IRQ is not set)
		  7 = CPURST  (CPU reset only)

config TC4X_SMU_DISABLE_DOUBLE_RESET_GUARD
	bool "Disable SMU double reset guard (development only)"
	default n
	---help---
		The TC4x SMM latches an "SMU reset in progress" flag on the
		first SMU-triggered Application Reset and holds the chip in
		permanent reset if a second SMU reset occurs before power
		cycle, preventing runaway watchdog reset loops.

		Enable this to clear SMM.RSTSTATCLR.CLRSMUIRF at every boot
		so repeated WDT resets do not lock up the board during
		development and testing.  Do NOT enable this in production.

config TC4X_SMM_ARM_SMUSAFE0AR
	bool "Arm SMM.RSTTRIGCTRLA.SMUSAFE0AR for Application Reset"
	default n
	---help---
		Enable SMU_SAFE0 reset requests to generate an Application Reset.
		This is required when WDT alarms use the RESET reaction.

endif # TC4X_SMU

# I2C
menuconfig TC4X_I2C
	bool "TC4x I2C Master Driver"
	default n
	depends on I2C
	select ARCH_HAVE_I2CRESET
	---help---
		Enable I2C master driver for Infineon Aurix TC4x.

if TC4X_I2C

config TC4X_I2C_CLOCK_FREQ
	int "I2C peripheral source clock (fI2C) in Hz"
	default 100000000
	---help---
		The fI2C clock frequency from the CCU. Check your clock
		tree configuration. Default assumes 100 MHz.

config TC4X_I2C0
	bool "Enable I2C0"
	default n

if TC4X_I2C0

config TC4X_I2C0_FREQUENCY
	int "I2C0 default bus frequency"
	default 100000
	---help---
		Default I2C bus speed in Hz.
		standard mode (100 kHz)
		fast mode (400 kHz)

config TC4X_I2C0_PISEL
	int "I2C0 pin input select"
	default 1
	range 0 7
	---help---
		Selects which port pins provide SDA/SCL input signals.

endif # TC4X_I2C0

config TC4X_I2C1
	bool "Enable I2C1"
	default n

if TC4X_I2C1

config TC4X_I2C1_FREQUENCY
	int "I2C1 default bus frequency"
	default 100000

config TC4X_I2C1_PISEL
	int "I2C1 pin input select"
	default 0
	range 0 7

endif # TC4X_I2C1

config TC4X_I2C2
	bool "Enable I2C2"
	default n

if TC4X_I2C2

config TC4X_I2C2_FREQUENCY
	int "I2C2 default bus frequency"
	default 100000

config TC4X_I2C2_PISEL
	int "I2C2 pin input select"
	default 0
	range 0 7

endif # TC4X_I2C2

endif # TC4X_I2C

# QSPI
menuconfig TC4X_QSPI
	bool "TC4xx QSPI master driver"
	default n
	depends on SPI
        select SPI_DRIVER
        select SPI_EXCHANGE
        ---help---
                Enable the polled-mode QSPI master driver for TC4Dx.
                Provides a NuttX spi_ops_s lower-half built on top of the
                dedicated QSPI peripheral with hardware SLSO chip selects.
                Automatically enables the SPI character driver (/dev/spiN)
                and the spi_exchange() transfer operation.

if TC4X_QSPI

config TC4X_QSPI_FPER_HZ
        int "fPER clock feeding the QSPI module (Hz)"
        default 200000000
        ---help---
                Peripheral PLL clock frequency driving the QSPI module.
                TC4Dx boards typically run fPER at 200 MHz via the PER PLL
                (PERCCUCON0.CLKSELQSPI=2, QSPIDIV=1).  Adjust if a different
                clock source or divider is configured in tc4x_clockconfig.c.

if TC4X_QSPI0
config TC4X_QSPI0_DEFAULT_CS
	int "QSPI0 default hardware CS (SLSO index)"
	default 0
	range 0 15
config TC4X_QSPI0_MRIS
	int "QSPI0 MRIS pin input select"
	default 0
	range 0 7
config TC4X_QSPI0_TXIRQ
	int "QSPI0 TX interrupt node index (IRQ_QSPI0_TX)"
	default 280
config TC4X_QSPI0_RXIRQ
	int "QSPI0 RX interrupt node index (IRQ_QSPI0_RX)"
	default 281
config TC4X_QSPI0_ERIRQ
	int "QSPI0 Error interrupt node index (IRQ_QSPI0_ERR)"
	default 282
endif # TC4X_QSPI0

config TC4X_QSPI1
	bool "Enable QSPI1"
	default n

if TC4X_QSPI1
config TC4X_QSPI1_DEFAULT_CS
	int "QSPI1 default hardware CS (SLSO index)"
	default 0
	range 0 15
config TC4X_QSPI1_MRIS
	int "QSPI1 MRIS pin input select"
	default 0
	range 0 7
config TC4X_QSPI1_TXIRQ
	int "QSPI1 TX interrupt node index (IRQ_QSPI1_TX)"
	default 285
config TC4X_QSPI1_RXIRQ
	int "QSPI1 RX interrupt node index (IRQ_QSPI1_RX)"
	default 286
config TC4X_QSPI1_ERIRQ
	int "QSPI1 Error interrupt node index (IRQ_QSPI1_ERR)"
	default 287
endif # TC4X_QSPI1

config TC4X_QSPI2
	bool "Enable QSPI2"
	default n

if TC4X_QSPI2
config TC4X_QSPI2_DEFAULT_CS
	int "QSPI2 default hardware CS (SLSO index)"
	default 0
	range 0 15
config TC4X_QSPI2_MRIS
	int "QSPI2 MRIS pin input select"
	default 0
	range 0 7
config TC4X_QSPI2_TXIRQ
	int "QSPI2 TX interrupt node index (IRQ_QSPI2_TX)"
	default 290
config TC4X_QSPI2_RXIRQ
	int "QSPI2 RX interrupt node index (IRQ_QSPI2_RX)"
	default 291
config TC4X_QSPI2_ERIRQ
	int "QSPI2 Error interrupt node index (IRQ_QSPI2_ERR)"
	default 292
endif # TC4X_QSPI2

config TC4X_QSPI3
	bool "Enable QSPI3"
	default n

if TC4X_QSPI3
config TC4X_QSPI3_DEFAULT_CS
	int "QSPI3 default hardware CS (SLSO index)"
	default 0
	range 0 15
config TC4X_QSPI3_MRIS
	int "QSPI3 MRIS pin input select"
	default 0
	range 0 7
config TC4X_QSPI3_TXIRQ
	int "QSPI3 TX interrupt node index (IRQ_QSPI3_TX)"
	default 295
config TC4X_QSPI3_RXIRQ
	int "QSPI3 RX interrupt node index (IRQ_QSPI3_RX)"
	default 296
config TC4X_QSPI3_ERIRQ
	int "QSPI3 Error interrupt node index (IRQ_QSPI3_ERR)"
	default 297
endif # TC4X_QSPI3

config TC4X_QSPI4
	bool "Enable QSPI4 (mikroBUS SPI header)"
	default n
	---help---
		Enable QSPI4.  On the a3g-tc4d7-lite board QSPI4 is wired
                to the SEMPER Flash / mikroBUS SPI header:
                MOSI=P22.0 (QSPI4_MTSR_F, ALT3),
                MISO=P22.1 (QSPI4_MRSTB_F, MRIS=1, input),
                SCLK=P22.3 (QSPI4_SCLK_F, ALT3),
                CS=SLSO6 (P23.1, ALT3).

if TC4X_QSPI4
config TC4X_QSPI4_DEFAULT_CS
        int "QSPI4 default hardware CS (SLSO index)"
        default 6
        range 0 15
config TC4X_QSPI4_MRIS
        int "QSPI4 MRIS pin input select"
        default 1
        range 0 7
config TC4X_QSPI4_LOOPBACK
        bool "Enable internal loopback on QSPI4"
        default n
        ---help---
                Enable GLOBALCON.LB to internally connect MTSR to MRST.
                Use this for spi_test /dev/spi1 without an external
                MOSI->MISO jumper wire.
config TC4X_QSPI4_TXIRQ
	int "QSPI4 TX interrupt node index (IRQ_QSPI4_TX)"
	default 300
config TC4X_QSPI4_RXIRQ
	int "QSPI4 RX interrupt node index (IRQ_QSPI4_RX)"
	default 301
config TC4X_QSPI4_ERIRQ
	int "QSPI4 Error interrupt node index (IRQ_QSPI4_ERR)"
	default 302
endif # TC4X_QSPI4

config TC4X_QSPI5
	bool "Enable QSPI5"
	default n

if TC4X_QSPI5
config TC4X_QSPI5_DEFAULT_CS
	int "QSPI5 default hardware CS (SLSO index)"
	default 0
	range 0 15
config TC4X_QSPI5_MRIS
	int "QSPI5 MRIS pin input select"
	default 0
	range 0 7
config TC4X_QSPI5_TXIRQ
	int "QSPI5 TX interrupt node index (IRQ_QSPI5_TX)"
	default 305
config TC4X_QSPI5_RXIRQ
	int "QSPI5 RX interrupt node index (IRQ_QSPI5_RX)"
	default 306
config TC4X_QSPI5_ERIRQ
	int "QSPI5 Error interrupt node index (IRQ_QSPI5_ERR)"
	default 307
endif # TC4X_QSPI5

config TC4X_QSPI6
	bool "Enable QSPI6"
	default n

if TC4X_QSPI6
config TC4X_QSPI6_DEFAULT_CS
	int "QSPI6 default hardware CS (SLSO index)"
	default 0
	range 0 15
config TC4X_QSPI6_MRIS
	int "QSPI6 MRIS pin input select"
	default 0
	range 0 7
config TC4X_QSPI6_TXIRQ
	int "QSPI6 TX interrupt node index (IRQ_QSPI6_TX)"
	default 310
config TC4X_QSPI6_RXIRQ
	int "QSPI6 RX interrupt node index (IRQ_QSPI6_RX)"
	default 311
config TC4X_QSPI6_ERIRQ
	int "QSPI6 Error interrupt node index (IRQ_QSPI6_ERR)"
	default 312
endif # TC4X_QSPI6

config TC4X_QSPI7
	bool "Enable QSPI7"
	default n

if TC4X_QSPI7
config TC4X_QSPI7_DEFAULT_CS
	int "QSPI7 default hardware CS (SLSO index)"
	default 0
	range 0 15
config TC4X_QSPI7_MRIS
	int "QSPI7 MRIS pin input select"
	default 0
	range 0 7
config TC4X_QSPI7_TXIRQ
	int "QSPI7 TX interrupt node index (IRQ_QSPI7_TX)"
	default 315
config TC4X_QSPI7_RXIRQ
	int "QSPI7 RX interrupt node index (IRQ_QSPI7_RX)"
	default 316
config TC4X_QSPI7_ERIRQ
	int "QSPI7 Error interrupt node index (IRQ_QSPI7_ERR)"
	default 317
endif # TC4X_QSPI7

endif # TC4X_QSPI

config TC4X_XSPI
	bool "xSPI controller"
	default n
	select XSPI
	select XSPI_DW_SSI
	select XSPI_DW_SSI_HAS_DDR
	select XSPI_DW_SSI_HAS_HYPERBUS
	select XSPI_DW_SSI_HAS_DMA
	select XSPI_DW_SSI_HAS_XIP
	---help---
		Enable the TC4xx xSPI controller. Provides SoC glue around
		the Synopsys DWC_SSI IP core driver for the single xSPI
		instance on TC4Dx devices.

if TC4X_XSPI

config TC4X_XSPI_SSI_CLK_HZ
	int "xSPI SSI_clk rate (Hz)"
	default 100000000
	---help---
		Input SSI_clk frequency feeding the xSPI controller. Used by
		the IP driver to compute the BAUDR divider. The default is a
		placeholder; set from the board clock tree.

config TC4X_XSPI_PORTSEL_GPIO
	bool "Route via GPIO pads (port 20) instead of HSFAST (port 16)"
	default n
	---help---
		Select GPIO pad routing for reduced functionality mode:
		SDR only, quad max, 25 MHz max, 3 V devices only.
		Useful for early bring-up on boards that expose port 20 pins
		on headers. Clear this for production HSFAST routing.

endif # TC4X_XSPI

# SPI
config TC4X_ASCLIN_SPI
	bool "ASCLIN SPI master support"
	default n
	depends on SPI
	---help---
		Enable SPI master mode on ASCLIN modules.  The ASCLIN IP supports
		UART, LIN, and SPI modes.  This option enables the SPI lower-half
		driver that implements the NuttX spi_ops_s interface.

		Chip select is managed via GPIO, not the hardware ASLSO signal.
		Each bus instance requires its own ASCLIN module (separate from
		any ASCLIN used for UART console).

if TC4X_ASCLIN_SPI

config TC4X_ASCLIN3_SPI
	bool "ASCLIN3 as SPI bus 0 (mikroBUS pins)"
	default y
	---help---
		Use ASCLIN3 for SPI bus 0.  On a3g-tc4d7-lite this is wired to
		the mikroBUS connector SPI pins (verified against iLLD
		IfxAsclin_PinMap_TC4Dx_BGA292_COM):

		  MOSI: P15.6 (ASCLIN3.TX, ALT2)   - mikroBUS pin 6
		  MISO: P15.7 (ASCLIN3.RXA)        - mikroBUS pin 5
		  SCLK: P15.8 (ASCLIN3.SCLK, ALT6) - mikroBUS pin 4
		  CS:   P14.7 (GPIO)               - mikroBUS pin 3

		ASCLIN3 has no SLSO line on a header-accessible pin, so CS is
		driven as a plain GPIO from the SPI driver's select callback.

config TC4X_ASCLIN3_SPI_LOOPBACK
	bool "Enable loopback on ASCLIN3 SPI"
	default n
	depends on TC4X_ASCLIN3_SPI
	---help---
		Enable internal loopback (IOCR.LB) for ASCLIN3 SPI.  TX is
		internally connected to RX.  Useful for driver validation
		without external wiring.  Disable for real hardware use.

config TC4X_ASCLIN_SPI_CHARDEV
	bool "Register SPI character device"
	default y
	depends on SPI_DRIVER
	---help---
		Register /dev/spiN character device via spi_register().
		Enables userspace access through standard SPI ioctls.

endif # TC4X_ASCLIN_SPI


# eGTM
menuconfig TC4X_EGTM_PWM
	bool "TC4X eGTM PWM (TOM)"
	default n
	---help---
		Enable the eGTM TOM PWM HAL (CLC + CMU + TOM + TGC + ICM).
		Provides the tc4x_egtm_* C API. Select the lower-half option
		below to also expose /dev/pwmN via the NuttX standard PWM
		framework.

if TC4X_EGTM_PWM

config TC4X_EGTM_PWM_LOWERHALF
	bool "Register NuttX standard PWM driver (/dev/pwmN)"
	default n
	select PWM
	---help---
		Wraps the eGTM HAL behind the NuttX pwm_ops_s vtable so the
		channels are reachable via the upper-half PWM character
		driver (open("/dev/pwm<minor>") + PWMIOC_* ioctls). The
		board bringup must call tc4x_egtm_pwm_register() once per
		/dev/pwmN node.

if TC4X_EGTM_PWM_LOWERHALF

config TC4X_EGTM_PWM_GCLK_DEN
	int "CMU GCLK_DEN (GCLK = feGTM / DEN)"
	default 1
	range 1 16777215
	---help---
		CMU divider for GCLK. Leave at 1; the driver runs the TOM
		off the fixed FXCLK tap 0 (tick = feGTM / 2).

endif # TC4X_EGTM_PWM_LOWERHALF

endif # TC4X_EGTM_PWM

# GPT12 PWM — shared instance base address
config TC4X_GPT120_BASE
	hex "GPT12 instance base address"
	default 0xF0020000
	depends on TC4X_GPT1_PWM || TC4X_GPT2_PWM
	---help---
		Base address of the GPT12 instance used for PWM.
		GPT120=0xF0020000, GPT121=0xF0020200,
		GPT122=0xF0020400, GPT123=0xF0020600.

# GPT12 PWM (GPT1 block: T2/T3/T4)
menuconfig TC4X_GPT1_PWM
	bool "TC4xx GPT1 PWM output (T2/T3/T4)"
	default n
	depends on PWM
	---help---
		Enable GPT1-block PWM on /dev/pwm0.
		Uses T3 as core timer, T2/T4 for high/low-phase reload.

if TC4X_GPT1_PWM

config TC4X_GPT1_PWM_T3_SRN
	int "GPT12 T3 overflow SRN index"
	default 1410
	---help---
		NuttX IRQ number for the T3 overflow interrupt.
		GPT120=1410, GPT121=1416, GPT122=1422, GPT123=1428.

endif # TC4X_GPT1_PWM

# GPT12 PWM (GPT2 block: T6/CAPREL)
menuconfig TC4X_GPT2_PWM
	bool "TC4xx GPT2 PWM output (T6/CAPREL)"
	default n
	depends on PWM
	---help---
		Enable GPT2-block PWM on /dev/pwm1.
		Uses T6 as core timer with CAPREL reload on overflow.

if TC4X_GPT2_PWM

config TC4X_GPT2_PWM_T6_SRN
	int "GPT12 T6 overflow SRN index"
	default 1413
	---help---
		NuttX IRQ number for the T6 overflow interrupt.
		GPT120=1413, GPT121=1419, GPT122=1425, GPT123=1431.

endif # TC4X_GPT2_PWM

menuconfig TC4X_I2S
	bool "TC48x AUDIO TDM / I2S driver"
	default n
	depends on I2S && TC4X_CHIP_TC487
	---help---
		Enable the AURIX TC48x AUDIO TDM audio-serial (I2S) lower-half
		driver.  The SoC is the I2S master (BCLK/WS/MCLK from the 98.304 MHz
		Audio PLL).  AUDIO exists only on TC48x, hence the TC4X_CHIP_TC487
		dependency.  Default data path is CPU FIFO fill/drain.

if TC4X_I2S

comment "Common I2S/TDM options (shared by all instances)"

config TC4X_I2S_MAXINFLIGHT
	int "Maximum in-flight audio buffers"
	default 16
	range 2 64
	---help---
		Preallocated buffer containers shared by the TX and RX queues:
		the max number of audio buffers enqueued but not yet completed.
		Shared by every enabled instance.

# Per-instance options (TDM0..2, each opt-in like QSPI)

config TC4X_I2S0
	bool "Enable I2S/TDM instance 0"
	default n
	---help---
		Enable AUDIO TDM instance 0.  Each TDM instance is opt-in; the board
		selects and wires the instances it uses.

if TC4X_I2S0

config TC4X_I2S0_TX_IOMUX_SEL
	int "I2S0 TX pad-group select (A/B/C/D = 0..3)"
	default 0
	range 0 3
	---help---
		TX_IOMUX_CTL pad-group for instance 0 (A/B/C/D = 0..3), selecting
		which pad set carries the TX signals.

config TC4X_I2S0_RX_IOMUX_SEL
	int "I2S0 RX pad-group select (A/B/C/D = 0..3)"
	default 3
	range 0 3
	---help---
		RX_IOMUX_CTL pad-group for instance 0 that feeds
		RX_SDI/SCK/FSYNC/MCK (A/B/C/D = 0..3).

config TC4X_I2S0_MCK_DIV
	int "I2S0 MCKO divider code (0=/1, 1=/2, 2=/4, 3=/8)"
	default 2
	range 0 3
	---help---
		Instance-0 TX/RX interface MCK_DIV field.  MCKO = clk_if / MCK_DIV
		(clk_if = 98.304 MHz); code 2 gives MCKO = APLL/4 = 24.576 MHz.  The
		codec must be configured for the same MCLK.  MCK_DIV is per-TDM.

config TC4X_I2S0_TX_DMA
	bool "I2S0 TX via System DMA (SDMA) offload"
	default n
	depends on TRICORE_DMA
	---help---
		Offload the instance-0 TX FIFO fill to the System DMA (SDMA0).
		Uses RROAT + one-shot SCH bootstrap; 32-bit samples only (narrower
		widths fall back to CPU fill).

config TC4X_I2S0_TX_DMA_CHAN
	int "I2S0 TX SDMA channel"
	default 2
	range 0 127
	depends on TC4X_I2S0_TX_DMA
	---help---
		Free SDMA0 channel serving the instance-0 TX FIFO.

config TC4X_I2S0_RX_DMA
	bool "I2S0 RX via System DMA (SDMA) offload"
	default n
	depends on TRICORE_DMA
	---help---
		Offload the instance-0 RX FIFO drain to the System DMA (SDMA0).
		32-bit samples only.

config TC4X_I2S0_RX_DMA_CHAN
	int "I2S0 RX SDMA channel"
	default 3
	range 0 127
	depends on TC4X_I2S0_RX_DMA
	---help---
		Free SDMA0 channel serving the instance-0 RX FIFO (distinct from TX).

config TC4X_I2S0_LOOPBACK
	bool "I2S0 internal RX self-test loopback (TX_SDO -> RX_SDI)"
	default n
	---help---
		Route TX_SDO straight back into RX_SDI via the TDM block's internal
		loopback (RX_TEST_CTL) to validate the RX datapath with no external
		pins, codec or mic.  Leave disabled for normal operation.

config TC4X_I2S0_TX_SLAVE
	bool "I2S0 TX is an external clock slave"
	default n
	---help---
		Run instance-0 TX as a clock slave (TX_CTL.MS = 0): BCLK/FSYNC come
		from the TX input pads instead of the SoC.  Default is master.

config TC4X_I2S0_RX_SLAVE
	bool "I2S0 RX is an external clock slave"
	default n
	---help---
		Run instance-0 RX as a clock slave (RX_CTL.MS = 0): BCLK/FSYNC come
		from the RX input pads (external master or looped-back TX clock).

endif # TC4X_I2S0

config TC4X_I2S1
	bool "Enable I2S/TDM instance 1"
	default n
	---help---
		Enable AUDIO TDM instance 1.  A board that uses it must wire and
		supply this instance's pads.

if TC4X_I2S1

config TC4X_I2S1_TX_IOMUX_SEL
	int "I2S1 TX pad-group select (A/B/C/D = 0..3)"
	default 0
	range 0 3

config TC4X_I2S1_RX_IOMUX_SEL
	int "I2S1 RX pad-group select (A/B/C/D = 0..3)"
	default 3
	range 0 3

config TC4X_I2S1_MCK_DIV
	int "I2S1 MCKO divider code (0=/1, 1=/2, 2=/4, 3=/8)"
	default 2
	range 0 3

config TC4X_I2S1_TX_DMA
	bool "I2S1 TX via System DMA (SDMA) offload"
	default n
	depends on TRICORE_DMA

config TC4X_I2S1_TX_DMA_CHAN
	int "I2S1 TX SDMA channel"
	default 4
	range 0 127
	depends on TC4X_I2S1_TX_DMA

config TC4X_I2S1_RX_DMA
	bool "I2S1 RX via System DMA (SDMA) offload"
	default n
	depends on TRICORE_DMA

config TC4X_I2S1_RX_DMA_CHAN
	int "I2S1 RX SDMA channel"
	default 5
	range 0 127
	depends on TC4X_I2S1_RX_DMA

config TC4X_I2S1_LOOPBACK
	bool "I2S1 internal RX self-test loopback (TX_SDO -> RX_SDI)"
	default n

config TC4X_I2S1_TX_SLAVE
	bool "I2S1 TX is an external clock slave"
	default n

config TC4X_I2S1_RX_SLAVE
	bool "I2S1 RX is an external clock slave"
	default n

endif # TC4X_I2S1

config TC4X_I2S2
	bool "Enable I2S/TDM instance 2"
	default n
	---help---
		Enable AUDIO TDM instance 2.  A board that uses it must wire and
		supply this instance's pads.

if TC4X_I2S2

config TC4X_I2S2_TX_IOMUX_SEL
	int "I2S2 TX pad-group select (A/B/C/D = 0..3)"
	default 0
	range 0 3

config TC4X_I2S2_RX_IOMUX_SEL
	int "I2S2 RX pad-group select (A/B/C/D = 0..3)"
	default 3
	range 0 3

config TC4X_I2S2_MCK_DIV
	int "I2S2 MCKO divider code (0=/1, 1=/2, 2=/4, 3=/8)"
	default 2
	range 0 3

config TC4X_I2S2_TX_DMA
	bool "I2S2 TX via System DMA (SDMA) offload"
	default n
	depends on TRICORE_DMA

config TC4X_I2S2_TX_DMA_CHAN
	int "I2S2 TX SDMA channel"
	default 6
	range 0 127
	depends on TC4X_I2S2_TX_DMA

config TC4X_I2S2_RX_DMA
	bool "I2S2 RX via System DMA (SDMA) offload"
	default n
	depends on TRICORE_DMA

config TC4X_I2S2_RX_DMA_CHAN
	int "I2S2 RX SDMA channel"
	default 7
	range 0 127
	depends on TC4X_I2S2_RX_DMA

config TC4X_I2S2_LOOPBACK
	bool "I2S2 internal RX self-test loopback (TX_SDO -> RX_SDI)"
	default n

config TC4X_I2S2_TX_SLAVE
	bool "I2S2 TX is an external clock slave"
	default n

config TC4X_I2S2_RX_SLAVE
	bool "I2S2 RX is an external clock slave"
	default n

endif # TC4X_I2S2

endif # TC4X_I2S

menuconfig TC4X_GETH
	bool "Infineon Tricore GETH support"
	default n
	depends on NET_DWXGMAC
	---help---
		Enable Infineon Tricore GETH support

if TC4X_GETH

config TRICORE_GETH_BASE
	hex "Tricore GETH base address"
	default 0xf9000000

config TRICORE_GETH_BRIDGE_IRQ
	int "Tricore GETH bridge interrupt number"
	default 760

choice
	prompt "GETH MII interface mode"
	default TRICORE_GETH_IF_RMII
	---help---
		How the MAC is wired to the PHY on this board.

config TRICORE_GETH_IF_RMII
	bool "RMII"
	---help---
		Reduced MII straight out of the port pads.

config TRICORE_GETH_IF_SGMII
	bool "SGMII"
	---help---
		SGMII over the HSPHY SerDes, via XPCS.  Needs the VDDPH_PHY
		analog supplies and an XPCS bring-up before the MAC is usable.

endchoice

endif # TC4X_GETH
```
