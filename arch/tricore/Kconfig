## arch/tricore/src/tc3x/Kconfig
```kconfig
#
# For a description of the syntax of this configuration file,
# see the file kconfig-language.txt in the NuttX tools repository.
#

comment "Infineon AURIX TC3X Chip"

choice
	prompt "Infineon AURIX TC3X Chip selection"
	default TC3X_CHIP_TC375

config TC3X_CHIP_TC375
	bool "TC375 SoC"
	---help---
		Infineon AURIX TC375.

config TC3X_CHIP_TC397
	bool "TC397 SoC"
	---help---
		Infineon AURIX TC397.

endchoice

config ARCH_TRICORE_CPU_COUNT
	int "TRICORE CPU count"
	default 1
	---help---
		Tricore CPU count

# I2C
menuconfig TC3X_I2C
	bool "TC3x I2C Master Driver"
	default n
	depends on I2C
	select ARCH_HAVE_I2CRESET
	---help---
		Enable I2C master driver for Infineon Aurix TC3x.

if TC3X_I2C

config TC3X_I2C_CLOCK_FREQ
	int "I2C peripheral source clock in Hz"
	default 100000000
	---help---
		The I2C clock frequency from the CCU. Check your clock
		tree configuration. Default assumes 100 MHz.

config TC3X_I2C0
	bool "Enable I2C0"
	default n

if TC3X_I2C0

config TC3X_I2C0_FREQUENCY
	int "I2C0 default bus frequency"
	default 100000
	---help---
		Default I2C bus speed in Hz.
		standard mode (100 kHz)
		fast mode (400 kHz)

config TC3X_I2C0_PISEL
	int "I2C0 pin input select"
	default 1
	range 0 7
	---help---
		Selects which port pins provide SDA/SCL input signals.

endif # TC3X_I2C0

config TC3X_I2C1
	bool "Enable I2C1"
	default n

if TC3X_I2C1

config TC3X_I2C1_FREQUENCY
	int "I2C1 default bus frequency"
	default 100000

config TC3X_I2C1_PISEL
	int "I2C1 pin input select"
	default 0
	range 0 7

endif # TC3X_I2C1

config TC3X_I2C2
	bool "Enable I2C2"
	default n

if TC3X_I2C2

config TC3X_I2C2_FREQUENCY
	int "I2C2 default bus frequency"
	default 100000

config TC3X_I2C2_PISEL
	int "I2C2 pin input select"
	default 0
	range 0 7

endif # TC3X_I2C2

endif # TC3X_I2C

# QSPI (Synchronous Serial Interface) -- TC3x hardware QSPI block
menuconfig TC3X_QSPI
	bool "TC3x QSPI master driver"
	default n
	depends on SPI
	---help---
		Enable the polled-mode QSPI master driver for the TC3x (TC397)
		family.  Provides a NuttX spi_ops_s lower-half built on top of
		the dedicated QSPI peripheral with hardware SLSO chip selects.

if TC3X_QSPI

config TC3X_QSPI_FSPB_HZ
	int "fSPB clock feeding the QSPI module (Hz)"
	default 100000000
	---help---
		Source clock frequency that drives the QSPI peripheral.  TC397
		runs fSPB at 100 MHz by default; adjust to match your clock-tree
		configuration.

config TC3X_QSPI2
	bool "Enable QSPI2"
	default n
	---help---
		Enable QSPI2 as a NuttX SPI bus.  On the TC397 ADAS Kit, QSPI2
		is wired to the TLF30682QVS01 PMIC via SLSO1 with MTSR=P15.6,
		MRST=P15.7, SCLK=P15.8, SLSO1=P14.2 (all ALT3).

if TC3X_QSPI2

config TC3X_QSPI2_DEFAULT_CS
	int "Default hardware CS (SLSO index, 0..15)"
	default 1
	range 0 15
	---help---
		Default SLSO line driven by the QSPI2 module.  TLF30682 on the
		TC397 ADAS Kit uses SLSO1.

endif # TC3X_QSPI2

config TC3X_QSPI3
	bool "TC3x QSPI3 module"
	default n
	---help---
		Enable the QSPI3 module driver. On the A2G-TC397XA-3V3-TFT board
		QSPI3 is wired out via header X103 (P02.5/6/7/8) for external
		SPI peripherals.

config TC3X_QSPI3_DEFAULT_CS
	int "TC3x QSPI3 default SLSO index"
	depends on TC3X_QSPI3
	range 0 15
	default 0
	---help---
		Hardware SLSO index used for the default chip select. For the
		W25Q128JV flash wired to P02.8, this is SLSO0 (= 0).

endif # TC3X_QSPI

config TC3X_WDT
	bool "TC3x Watchdog Timer driver"
	default n
	depends on WATCHDOG
	---help---
		Enable the TC3x CPU watchdog timer driver.  Registers
		/dev/watchdog0 backed by SCU.WDTCPU0_CON0/CON1/SR.

		WDT overflow generates an alarm to the SMU.  Enable
		CONFIG_TC3X_SMU to wire the overflow alarm to an
		application reset via tc3x_smu_initialize().

config TC3X_WDT_FSPB
	int "SPB clock frequency (Hz) feeding the TC3x WDT"
	default 100000000
	depends on TC3X_WDT
	---help---
		Source clock for the WDT divider chain.  TC375 runs fSPB at
		100 MHz by default; adjust to match your clock-tree.

# GPT1 PWM
menuconfig TC3X_GPT1_PWM
	bool "TC3xx GPT1 PWM output (T2/T3/T4)"
	default n
	depends on PWM
	---help---
		Enable the GPT1-block PWM lower-half driver.  Uses timers
		T3 (core), T2, and T4 (auxiliaries) to generate a PWM signal on
		the T3OUT alternate-function pin.  Provides /dev/pwm0.

		Frequency range depends on fSPB (100 MHz default) and the
		prescaler combination chosen at runtime.  With the widest
		prescaler (BPS1=÷32, T3I=÷128) the minimum frequency is
		approximately 0.4 Hz; the maximum with BPS1=÷4, T3I=÷1 is
		approximately 381 kHz.

if TC3X_GPT1_PWM

config TC3X_GPT120_BASE
	hex "GPT120 module base address"
	default 0xF0001800
	---help---
		Base address of the GPT120 peripheral. Verify against the TC3xx
		User Manual address map chapter before use.

config TC3X_GPT1_PWM_T3_SRN
	int "GPT120 T3 overflow SRN (Service Request Node) index"
	default 186
	range 1 2047
	---help---
		NuttX IRQ number for the GPT120 T3 overflow interrupt.
		186 = IRQ_GPT120_T3 (TC37x/TC39x SRC table).

endif # TC3X_GPT1_PWM

# GPT2 PWM
menuconfig TC3X_GPT2_PWM
	bool "TC3xx GPT2 PWM output (T6/CAPREL)"
	default n
	depends on PWM
	---help---
		Enable the GPT2-block PWM lower-half driver.  Uses timer T6
		and the CAPREL register to generate a PWM signal on the T6OUT
		alternate-function pin.  Provides /dev/pwm1.

		Differs from GPT1: CAPREL holds only one reload value, so the
		T6 overflow ISR switches it between the high and low phase
		preloads on each overflow.

if TC3X_GPT2_PWM

config TC3X_GPT2_PWM_T6_SRN
	int "GPT120 T6 overflow SRN (Service Request Node) index"
	default 189
	range 1 2047
	---help---
		NuttX IRQ number for the GPT120 T6 overflow interrupt.
		189 = IRQ_GPT120_T6 (TC37x/TC39x SRC table).

endif # TC3X_GPT2_PWM

# GPT12 Capture
menuconfig TC3X_GPT12_CAP
        bool "TC3xx GPT12 capture (T5/CAPREL)"
        default n
        depends on CAPTURE
        ---help---
                Enable the GPT2-block capture lower-half driver.  Uses timer
                T5 and CAPREL to measure the frequency and duty cycle of a
                signal on the CAPIN input pin.  Registers /dev/capN.

                T5 runs free in Timer mode.  Three consecutive edge captures
                (rising, falling, rising) give the period and pulse width.
                Frequency and duty cycle are derived from T5 tick counts.

                CAPREL is shared with the GPT2 PWM path (TC3X_GPT2_PWM).
                Both cannot be active simultaneously.  start() returns
                -EBUSY if T6 is already running.

if TC3X_GPT12_CAP

config TC3X_GPT12_CAP_CAPREL_SRN
        int "GPT12 CAPREL SRN (Service Request Node) index"
        default 184
        range 1 2047
        ---help---
                NuttX IRQ number for the GPT120 CAPREL interrupt.
                Verify the correct value for your specific TC3xx device.

config TC3X_GPT12_CAP_T5I
        int "T5 input prescaler (T5I field, 0=div1 .. 7=div128)"
        default 4
        range 0 7
        ---help---
                Per-timer prescaler for T5.  T5 clock = fGPT / 2^T5I
                where fGPT = fSPB / 2 (50 MHz with fSPB = 100 MHz).

                T5I=4 (default): f_T5 = 3.125 MHz, min freq ~48 Hz.
                T5I=6: f_T5 ~781 kHz, min freq ~12 Hz.
                T5I=7: f_T5 ~390 kHz, min freq ~6 Hz.

config TC3X_GPT12_CAP_CAPIN_SEL
        int "PISEL.ISCAPIN pin select (0=CAPINA, 1=CAPINB)"
        default 0
        range 0 1
        ---help---
                Selects which physical pin is routed to the CAPIN input.
                0 = CAPINA, 1 = CAPINB.
                Verify the alternate-function pin mapping for your device
                before changing this value.

endif # TC3X_GPT12_CAP

config TC3X_SMU
	bool "TC3xx Safety Management Unit (SMU_core) driver"
	default n
	---help---
		Enable the SMU_core driver for the Infineon AURIX TC3xx family.
		When CONFIG_TC3X_WDT is also enabled, the WDT timeout alarms
		(AG0 bits 0 and 6) are wired during tc3x_smu_initialize().
		The reaction depends on CONFIG_TC3X_SMU_IRQ:
		  IRQ mode:  IGCS0 + SRC_SMU0 ISR + RT escalation to RESET.
		  Fallback:  SMU_REACT_RESET (hardware-autonomous, no ISR).
if TC3X_SMU
config TC3X_SMU_IRQ
	bool "SMU interrupt handler via SRC_SMU0 (IRQ 564)"
	default n
	---help---
		Route IGCS0 alarm reactions to SRC_SMU0 and attach an ISR.
		The ISR logs the alarm, clears the sticky bit, and calls
		SMU_RTStop to acknowledge within the Recovery Timer window.
		Matches the Zephyr smu_aurix driver pattern for TC3X
		(base->AGC.B.IGCS0 = 0x1 in smu_aurix_init).
		If the ISR misses the Recovery Timer deadline, the SMU fires
		the escalation reaction as a hardware safety net.
		When disabled, WDT alarms use SMU_REACT_RESET directly
		(hardware-autonomous - safe even if OS has crashed).
config TC3X_SMU_DISABLE_DOUBLE_RESET_GUARD
	bool "Disable SMU double reset guard (development only)"
	default n
	---help---
		The TC3xx hardware holds the chip in permanent Application
		Reset if an SMU-induced reset occurs twice consecutively,
		preventing runaway watchdog reset loops.
		Enable this to clear the internal reset flag at every boot
		(WDTSCON1.CLRIRF) so repeated WDT resets do not lock up
		the board during development and testing.
		Do NOT enable this in production firmware.
config TC3X_SMU_WDT_REACTION
	int "WDT alarm default reaction code"
	default 2 if TC3X_SMU_IRQ
	default 6
	range 0 7
	---help---
		Reaction code written to all WDT alarm bits (AG8) during
		tc3x_smu_initialize().  This is the boot-time default;
		individual alarms can be reconfigured at runtime via the
		SMUIOC_CONFIGALARM ioctl.
		  0 = NONE    (no reaction -- WDT overflow silently ignored)
		  2 = IGCS0   (interrupt via SRC_SMU0, requires TC3X_SMU_IRQ)
		  3 = IGCS1   (interrupt via SRC_SMU1, requires TC3X_SMU_IRQ)
		  4 = IGCS2   (interrupt via SRC_SMU2, requires TC3X_SMU_IRQ)
		  6 = RESET   (hardware-autonomous Application Reset, default
		               when TC3X_SMU_IRQ is not set)
		  7 = CPURST  (CPU reset only)
endif # TC3X_SMU
```
