## boards/tricore/tc3xx/a2g-tc397xa-3v3-tft/configs/gpio_test/defconfig
```kconfig
#
# gpio_test: NSH on UART0 + /dev/gpio0..2 (P22.0 out, P22.2 in pull-up,
# P22.3 in pull-down) for the GPIO driver bring-up smoke harness.
#
# CONFIG_DEV_NULL is not set
# CONFIG_DEV_ZERO is not set
CONFIG_ARCH="tricore"
CONFIG_ARCH_BOARD="a2g-tc397xa-3v3-tft"
CONFIG_ARCH_BOARD_A2G_TC397XA_3V3_TFT=y
CONFIG_ARCH_CHIP="tc3xx"
CONFIG_ARCH_CHIP_FAMILY_TC3XX=y
CONFIG_ARCH_INTERRUPTSTACK=2048
CONFIG_ARCH_STACKDUMP=y
CONFIG_ARCH_TRICORE=y
CONFIG_BINFMT_DISABLE=y
CONFIG_BUILTIN=y
CONFIG_DISABLE_ENVIRON=y
CONFIG_DISABLE_MQUEUE=y
CONFIG_DISABLE_POSIX_TIMERS=y
CONFIG_DISABLE_PTHREAD=y
CONFIG_FLASH_SIZE=4194304
CONFIG_FLASH_START=0x80000000
CONFIG_FS_PROCFS=y
CONFIG_INIT_ENTRYNAME="main"
CONFIG_INIT_ENTRYPOINT="nsh_main"
CONFIG_NSH_ARCHINIT=y
CONFIG_NSH_BUILTIN_APPS=y
CONFIG_RAM_SIZE=5242880
CONFIG_RAM_START=0x90400000
CONFIG_RR_INTERVAL=1
CONFIG_SCHED_HPWORK=y
CONFIG_SCHED_HPWORKSTACKSIZE=4096
CONFIG_SYSLOG_CONSOLE=y
CONFIG_SYSTEM_NSH=y
CONFIG_TRICORE_ASCLINF_FREQUENCY=400000000
CONFIG_TRICORE_UART0=y
CONFIG_UART0_SERIAL_CONSOLE=y
CONFIG_USEC_PER_TICK=100
CONFIG_DEV_GPIO=y
CONFIG_BOARD_GPIO_TEST=y
CONFIG_TESTING_GPIO_TEST=y
```

## boards/tricore/tc4x/a3g-tc487-lite/Kconfig
```kconfig
#
# For a description of the syntax of this configuration file,
# see the file kconfig-language.txt in the NuttX tools repository.
#

if ARCH_BOARD_A3G_TC487_LITE

config BOARD_GPIO_TEST
	bool "Register Port-22 GPIO pins for gpio_test"
	default n
	depends on DEV_GPIO
	---help---
		Registers /dev/gpio0 (P22.0 output, init high), /dev/gpio1
		(P22.2 input pull-up), /dev/gpio2 (P22.3 input pull-down) on
		boot via aurix_gpio_lower_register().  Wire P22.0 to P22.2
		(or P22.3) externally to verify loopback with the gpio_test
		userspace app.

config BOARD_USER_LED_GPIO
	bool "Register on-board user LED1 (P03.9) as /dev/gpio0"
	default n
	depends on DEV_GPIO
	depends on !BOARD_GPIO_TEST
	---help---
		Registers TC487-Lite Kit user LED1 (P03.9) as /dev/gpio0
		via aurix_gpio_lower_register().  The pin is configured as
		push-pull output with init level HIGH so the LED is off at
		boot (the kit drives LED1 active-low).  Run the led_blink
		smoke test from tricore-apps to toggle it at 1 Hz.

endif
```

## boards/tricore/tc4x/a3g-tc487-lite/configs/nsh/defconfig
```kconfig
#
#
# You can use "make menuconfig" to make any modifications to the installed .config file.
# You can then do "make savedefconfig" to generate a new defconfig file that includes your
# modifications.
#
# CONFIG_DEV_NULL is not set
# CONFIG_DEV_ZERO is not set
CONFIG_ARCH="tricore"
CONFIG_ARCH_BOARD="a3g-tc487-lite"
CONFIG_ARCH_BOARD_A3G_TC487_LITE=y
CONFIG_ARCH_CHIP="tc4x"
CONFIG_ARCH_CHIP_FAMILY_TC4X=y
CONFIG_ARCH_INTERRUPTSTACK=2048
CONFIG_ARCH_STACKDUMP=y
CONFIG_ARCH_TRICORE=y
CONFIG_ARCH_TRICORE_CPU_COUNT=1
CONFIG_AUDIO=y
CONFIG_AUDIO_DRIVER_SPECIFIC_BUFFERS=y
CONFIG_AUDIO_TLV320AIC26=y
CONFIG_BINFMT_DISABLE=y
CONFIG_BOARD_LATE_INITIALIZE=y
CONFIG_BOARD_LOOPSPERMSEC=10000
CONFIG_BOARD_USER_LED_GPIO=y
CONFIG_BUILTIN=y
CONFIG_DEBUG_FEATURES=y
CONFIG_DEBUG_SYMBOLS=y
CONFIG_DEFAULT_TASK_STACKSIZE=8192
CONFIG_DEV_GPIO=y
CONFIG_DISABLE_POSIX_TIMERS=y
CONFIG_DRIVERS_AUDIO=y
CONFIG_EXAMPLES_GPIO=y
CONFIG_EXAMPLES_HELLO=y
CONFIG_EXAMPLES_I2S_SINE=y
CONFIG_FLASH_SIZE=4194304
CONFIG_FLASH_START=0x80000000
CONFIG_FS_PROCFS=y
CONFIG_I2S=y
CONFIG_INIT_ENTRYNAME="main"
CONFIG_INIT_ENTRYPOINT="nsh_main"
CONFIG_INTELHEX_BINARY=y
CONFIG_LIBM=y
CONFIG_NSH_ARCHINIT=y
CONFIG_NSH_BUILTIN_APPS=y
CONFIG_RAM_SIZE=524288
CONFIG_RAM_START=0x90000000
CONFIG_RR_INTERVAL=1
CONFIG_SCHED_HPWORK=y
CONFIG_SCHED_HPWORKSTACKSIZE=4096
CONFIG_SPI=y
CONFIG_SPI_DRIVER=y
CONFIG_SPI_EXCHANGE=y
CONFIG_SYSLOG_CONSOLE=y
CONFIG_SYSTEM_NSH=y
CONFIG_TC4X_CHIP_TC487=y
CONFIG_TC4X_I2S=y
CONFIG_TC4X_I2S0=y
CONFIG_TC4X_I2S0_TX_DMA=y
CONFIG_TC4X_I2S0_TX_IOMUX_SEL=0
CONFIG_TC4X_QSPI=y
CONFIG_TC4X_QSPI4=y
CONFIG_TRICORE_DMA=y
CONFIG_TRICORE_TOOLCHAIN_GNUC=y
CONFIG_TRICORE_UART1=y
CONFIG_UART1_SERIAL_CONSOLE=y
```

## boards/tricore/tc4x/a3g-tc4d7-lite/Kconfig
```kconfig
#
# For a description of the syntax of this configuration file,
# see the file kconfig-language.txt in the NuttX tools repository.
#

if ARCH_BOARD_A3G_TC4D7_LITE

config BOARD_GPIO_TEST
	bool "Register Port-22 GPIO pins for gpio_test"
	default n
	depends on DEV_GPIO
	depends on !TC4X_QSPI4 && !TC4X_QSPI5
	---help---
		Registers /dev/gpio0 (P22.0 output, init high), /dev/gpio1
		(P22.2 input pull-up), /dev/gpio2 (P22.3 input pull-down) on
		boot via aurix_gpio_lower_register().  Wire P22.0 to P22.2
		(or P22.3) externally to verify loopback with the gpio_test
		userspace app.

config BOARD_USER_LED_GPIO
	bool "Register on-board user LED1 (P03.9) as /dev/gpio0"
	default n
	depends on DEV_GPIO
	depends on !BOARD_GPIO_TEST
	---help---
		Registers TC4D7-Lite Kit user LED1 (P03.9) as /dev/gpio0
		via aurix_gpio_lower_register().  The pin is configured as
		push-pull output with init level HIGH so the LED is off at
		boot (the kit drives LED1 active-low).  Run the led_blink
		smoke test from tricore-apps to toggle it at 1 Hz.

if TC4X_EGTM_PWM_LOWERHALF

menu "TC4D7-Lite TOM PWM channels"

config TC4D7_PWM_ANY
	bool

config TC4D7_PWM_CH0
	bool "/dev/pwm0  = P00.0  -> TOM0_0  (TOUT9,  sel 0x14)"
	select TC4D7_PWM_ANY

config TC4D7_PWM_CH1
	bool "/dev/pwm1  = P00.1  -> TOM0_1  (TOUT10, sel 0x14)"
	select TC4D7_PWM_ANY

config TC4D7_PWM_CH2
	bool "/dev/pwm2  = P00.2  -> TOM0_2  (TOUT11, sel 0x14)"
	select TC4D7_PWM_ANY

config TC4D7_PWM_CH3
	bool "/dev/pwm3  = P00.3  -> TOM0_3  (TOUT12, sel 0x14)"
	select TC4D7_PWM_ANY

config TC4D7_PWM_CH4
	bool "/dev/pwm4  = P00.4  -> TOM0_11 (TOUT13, sel 0x10)"
	select TC4D7_PWM_ANY

config TC4D7_PWM_CH5
	bool "/dev/pwm5  = P00.5  -> TOM0_12 (TOUT14, sel 0x10)"
	select TC4D7_PWM_ANY

config TC4D7_PWM_CH6
	bool "/dev/pwm6  = P00.6  -> TOM0_13 (TOUT15, sel 0x10)"
	select TC4D7_PWM_ANY

config TC4D7_PWM_CH7
	bool "/dev/pwm7  = P00.7  -> TOM0_14 (TOUT16, sel 0x10)"
	select TC4D7_PWM_ANY

config TC4D7_PWM_CH8
	bool "/dev/pwm8  = P00.8  -> TOM0_15 (TOUT17, sel 0x10)"
	select TC4D7_PWM_ANY

config TC4D7_PWM_CH9
	bool "/dev/pwm9  = P00.9  -> TOM0_9  (TOUT18, sel 0x04)"
	select TC4D7_PWM_ANY

config TC4D7_PWM_CH10
	bool "/dev/pwm10 = P00.11 -> TOM0_10 (TOUT20, sel 0x04)"
	select TC4D7_PWM_ANY

config TC4D7_PWM_CH11
	bool "/dev/pwm11 = P03.3  -> TOM2_9  (TOUT274, sel 0x06) [CLS2]"
	select TC4D7_PWM_ANY

config TC4D7_PWM_CH12
	bool "/dev/pwm12 = P03.4  -> TOM2_10 (TOUT275, sel 0x15) [CLS2]"
	select TC4D7_PWM_ANY

endmenu

menu "TC4D7-Lite ATOM PWM channels"

config TC4D7_ATOM_ANY
	bool

config TC4D7_ATOM_CH0
	bool "/dev/pwm13 = P00.12 -> ATOM0_2 (TOUT21, sel 0x01, inverted) [ATOM CLS0]"
	select TC4D7_ATOM_ANY


config TC4D7_ATOM_CH1
	bool "/dev/pwm14 = P00.0  -> ATOM0_0 (TOUT9, sel 0x12) [ATOM CLS0]"
	depends on !TC4D7_PWM_CH0
	select TC4D7_ATOM_ANY

config TC4D7_ATOM_CH2
	bool "/dev/pwm15 = P00.1  -> ATOM0_1 (TOUT10, sel 0x12) [ATOM CLS0]"
	depends on !TC4D7_PWM_CH1
	select TC4D7_ATOM_ANY

config TC4D7_ATOM_CH3
	bool "/dev/pwm16 = P00.3  -> ATOM0_2 (TOUT12, sel 0x12) [ATOM CLS0]"
	depends on !TC4D7_PWM_CH3 && !TC4D7_ATOM_CH0
	select TC4D7_ATOM_ANY

config TC4D7_ATOM_CH4
	bool "/dev/pwm17 = P00.4  -> ATOM0_3 (TOUT13, sel 0x12) [ATOM CLS0]"
	depends on !TC4D7_PWM_CH4
	select TC4D7_ATOM_ANY

config TC4D7_ATOM_CH5
	bool "/dev/pwm18 = P00.5  -> ATOM0_4 (TOUT14, sel 0x12) [ATOM CLS0]"
	depends on !TC4D7_PWM_CH5
	select TC4D7_ATOM_ANY

config TC4D7_ATOM_CH6
	bool "/dev/pwm19 = P00.6  -> ATOM0_5 (TOUT15, sel 0x12) [ATOM CLS0]"
	depends on !TC4D7_PWM_CH6
	select TC4D7_ATOM_ANY

config TC4D7_ATOM_CH7
	bool "/dev/pwm20 = P00.7  -> ATOM0_6 (TOUT16, sel 0x12) [ATOM CLS0]"
	depends on !TC4D7_PWM_CH7
	select TC4D7_ATOM_ANY

config TC4D7_ATOM_CH8
	bool "/dev/pwm21 = P00.8  -> ATOM0_7 (TOUT17, sel 0x12) [ATOM CLS0]"
	depends on !TC4D7_PWM_CH8
	select TC4D7_ATOM_ANY

config TC4D7_ATOM_CH9
	bool "/dev/pwm22 = P03.3 -> ATOM1_1 (TOUT274, sel 0x02, inverted) [ATOM CLS1]"
	depends on !TC4D7_PWM_CH11
	select TC4D7_ATOM_ANY

config TC4D7_ATOM_CH10
	bool "/dev/pwm23 = P03.4 -> ATOM1_1 (TOUT275, sel 0x02) [ATOM CLS1]"
	depends on !TC4D7_PWM_CH12 && !TC4D7_ATOM_CH9
	select TC4D7_ATOM_ANY

config TC4D7_ATOM_CH11
	bool "/dev/pwm24 = P03.3 -> ATOM2_1 (TOUT274, sel 0x03) [ATOM CLS2]"
	depends on !TC4D7_PWM_CH11 && !TC4D7_ATOM_CH9
	select TC4D7_ATOM_ANY

config TC4D7_ATOM_CH12
	bool "/dev/pwm25 = P03.4 -> ATOM2_1 (TOUT275, sel 0x03, inverted) [ATOM CLS2]"
	depends on !TC4D7_PWM_CH12 && !TC4D7_ATOM_CH10
	select TC4D7_ATOM_ANY

endmenu

endif # TC4X_EGTM_PWM_LOWERHALF

endif
```

## boards/tricore/tc4x/triboard-tc4x7-com/Kconfig
```kconfig
#
# For a description of the syntax of this configuration file,
# see the file kconfig-language.txt in the NuttX tools repository.
#

if ARCH_BOARD_TRIBOARD_TC4X7_COM

config BOARD_TC4X7_BUTTONS
	bool "Enable button support"
	default y
	---help---
		Enable support for the user push button on the
		AURIX TC4X7 Triboard. The software-visible button is wired
		to P33.11.

if TC4X_EGTM_PWM_LOWERHALF

menu "Triboard TC4x7 PWM channels to register"

config TC4X7_PWM_ANY
	bool

config TC4X7_PWM_CH0
	bool "/dev/pwm0  = P00.0  -> TOM0_0  (TOUT9,   sel 0x14)"
	select TC4X7_PWM_ANY

config TC4X7_PWM_CH1
	bool "/dev/pwm1  = P00.1  -> TOM0_1  (TOUT10,  sel 0x14)"
	select TC4X7_PWM_ANY

config TC4X7_PWM_CH2
	bool "/dev/pwm2  = P00.2  -> TOM0_2  (TOUT11,  sel 0x14)"
	select TC4X7_PWM_ANY

config TC4X7_PWM_CH3
	bool "/dev/pwm3  = P00.3  -> TOM0_3  (TOUT12,  sel 0x14)"
	select TC4X7_PWM_ANY

config TC4X7_PWM_CH4
	bool "/dev/pwm4  = P00.4  -> TOM0_11 (TOUT13,  sel 0x10)"
	select TC4X7_PWM_ANY

config TC4X7_PWM_CH5
	bool "/dev/pwm5  = P00.5  -> TOM0_12 (TOUT14,  sel 0x10)"
	select TC4X7_PWM_ANY

config TC4X7_PWM_CH6
	bool "/dev/pwm6  = P00.6  -> TOM0_13 (TOUT15,  sel 0x10)"
	select TC4X7_PWM_ANY

config TC4X7_PWM_CH7
	bool "/dev/pwm7  = P00.7  -> TOM0_14 (TOUT16,  sel 0x10)"
	select TC4X7_PWM_ANY

config TC4X7_PWM_CH8
	bool "/dev/pwm8  = P00.8  -> TOM0_15 (TOUT17,  sel 0x10)"
	select TC4X7_PWM_ANY

config TC4X7_PWM_CH9
	bool "/dev/pwm9  = P00.9  -> TOM0_9  (TOUT18,  sel 0x04)"
	select TC4X7_PWM_ANY

config TC4X7_PWM_CH10
	bool "/dev/pwm10 = P00.11 -> TOM0_10 (TOUT20,  sel 0x04)"
	select TC4X7_PWM_ANY

config TC4X7_PWM_CH11
	bool "/dev/pwm11 = P01.4  -> TOM1_8  (TOUT112, sel 0x05) [CLS1]"
	select TC4X7_PWM_ANY

config TC4X7_PWM_CH12
	bool "/dev/pwm12 = P01.5  -> TOM1_8  (TOUT113, sel 0x05) [CLS1]"
	select TC4X7_PWM_ANY

config TC4X7_PWM_CH13
	bool "/dev/pwm13 = P01.6  -> TOM1_9  (TOUT114, sel 0x05) [CLS1]"
	select TC4X7_PWM_ANY

config TC4X7_PWM_CH14
	bool "/dev/pwm14 = P01.7  -> TOM1_9  (TOUT115, sel 0x05) [CLS1]"
	select TC4X7_PWM_ANY

config TC4X7_PWM_CH16
	bool "/dev/pwm16 = P03.2  -> TOM2_9  (TOUT273, sel 0x15) [CLS2]"
	select TC4X7_PWM_ANY

config TC4X7_PWM_CH17
	bool "/dev/pwm17 = P03.4  -> TOM2_10 (TOUT275, sel 0x15) [CLS2]"
	select TC4X7_PWM_ANY

config TC4X7_PWM_CH18
	bool "/dev/pwm18 = P03.11 -> TOM2_13 (TOUT282, sel 0x06) [CLS2]"
	select TC4X7_PWM_ANY

config TC4X7_PWM_CH19
	bool "/dev/pwm19 = P03.12 -> TOM2_14 (TOUT283, sel 0x15) [CLS2]"
	select TC4X7_PWM_ANY

config TC4X7_PWM_CH20
	bool "/dev/pwm20 = P03.14 -> TOM2_15 (TOUT285, sel 0x15) [CLS2]"
	select TC4X7_PWM_ANY

endmenu

menu "Triboard TC4x7 ATOM PWM channels"

config TC4X7_ATOM_ANY
	bool

config TC4X7_ATOM_CH0
	bool "/dev/pwm21 = P00.12 -> ATOM0_2 (TOUT21, sel 0x01, inverted)"
	select TC4X7_ATOM_ANY

config TC4X7_ATOM_CH1
	bool "/dev/pwm22 = P00.0  -> ATOM0_0 (TOUT9, sel 0x12)"
	depends on !TC4X7_PWM_CH0
	select TC4X7_ATOM_ANY

config TC4X7_ATOM_CH2
	bool "/dev/pwm23 = P00.1  -> ATOM0_1 (TOUT10, sel 0x12)"
	depends on !TC4X7_PWM_CH1
	select TC4X7_ATOM_ANY

config TC4X7_ATOM_CH3
	bool "/dev/pwm24 = P00.3  -> ATOM0_2 (TOUT12, sel 0x12)"
	depends on !TC4X7_PWM_CH3 && !TC4X7_ATOM_CH0
	select TC4X7_ATOM_ANY

config TC4X7_ATOM_CH4
	bool "/dev/pwm25 = P00.4  -> ATOM0_3 (TOUT13, sel 0x12)"
	depends on !TC4X7_PWM_CH4
	select TC4X7_ATOM_ANY

config TC4X7_ATOM_CH5
	bool "/dev/pwm26 = P00.5  -> ATOM0_4 (TOUT14, sel 0x12)"
	depends on !TC4X7_PWM_CH5
	select TC4X7_ATOM_ANY

config TC4X7_ATOM_CH6
	bool "/dev/pwm27 = P00.6  -> ATOM0_5 (TOUT15, sel 0x12)"
	depends on !TC4X7_PWM_CH6
	select TC4X7_ATOM_ANY

config TC4X7_ATOM_CH7
	bool "/dev/pwm28 = P00.7  -> ATOM0_6 (TOUT16, sel 0x12)"
	depends on !TC4X7_PWM_CH7
	select TC4X7_ATOM_ANY

config TC4X7_ATOM_CH8
	bool "/dev/pwm29 = P00.8  -> ATOM0_7 (TOUT17, sel 0x12)"
	depends on !TC4X7_PWM_CH8
	select TC4X7_ATOM_ANY

config TC4X7_ATOM_CH9
	bool "/dev/pwm30 = P01.4 -> ATOM1_0 (TOUT112, sel 0x02, inverted)"
	depends on !TC4X7_PWM_CH11
	select TC4X7_ATOM_ANY

config TC4X7_ATOM_CH10
	bool "/dev/pwm31 = P01.4 -> ATOM2_0 (TOUT112, sel 0x03)"
	depends on !TC4X7_PWM_CH11 && !TC4X7_ATOM_CH9
	select TC4X7_ATOM_ANY

config TC4X7_ATOM_CH11
	bool "/dev/pwm32 = P01.5 -> ATOM1_0 (TOUT113, sel 0x02)"
	depends on !TC4X7_PWM_CH12 && !TC4X7_ATOM_CH9
	select TC4X7_ATOM_ANY

config TC4X7_ATOM_CH12
	bool "/dev/pwm33 = P01.5 -> ATOM2_0 (TOUT113, sel 0x03, inverted)"
	depends on !TC4X7_PWM_CH12 && !TC4X7_ATOM_CH10
	select TC4X7_ATOM_ANY

config TC4X7_ATOM_CH13
	bool "/dev/pwm34 = P01.6 -> ATOM1_1 (TOUT114, sel 0x02, inverted)"
	depends on !TC4X7_PWM_CH13
	select TC4X7_ATOM_ANY

config TC4X7_ATOM_CH14
	bool "/dev/pwm35 = P01.6 -> ATOM2_1 (TOUT114, sel 0x03)"
	depends on !TC4X7_PWM_CH13 && !TC4X7_ATOM_CH13
	select TC4X7_ATOM_ANY

config TC4X7_ATOM_CH15
	bool "/dev/pwm36 = P01.7 -> ATOM1_1 (TOUT115, sel 0x02)"
	depends on !TC4X7_PWM_CH14 && !TC4X7_ATOM_CH13
	select TC4X7_ATOM_ANY

config TC4X7_ATOM_CH16
	bool "/dev/pwm37 = P01.7 -> ATOM2_1 (TOUT115, sel 0x03, inverted)"
	depends on !TC4X7_PWM_CH14 && !TC4X7_ATOM_CH15
	select TC4X7_ATOM_ANY

config TC4X7_ATOM_CH19
	bool "/dev/pwm40 = P03.2 -> ATOM1_1 (TOUT273, sel 0x11)"
	depends on !TC4X7_PWM_CH16 && !TC4X7_ATOM_CH13
	select TC4X7_ATOM_ANY

config TC4X7_ATOM_CH20
	bool "/dev/pwm41 = P03.2 -> ATOM2_7 (TOUT273, sel 0x12, inverted)"
	depends on !TC4X7_PWM_CH16
	select TC4X7_ATOM_ANY

config TC4X7_ATOM_CH21
	bool "/dev/pwm42 = P03.4 -> ATOM1_1 (TOUT275, sel 0x02)"
	depends on !TC4X7_PWM_CH17 && !TC4X7_ATOM_CH13
	select TC4X7_ATOM_ANY

config TC4X7_ATOM_CH22
	bool "/dev/pwm43 = P03.4 -> ATOM2_1 (TOUT275, sel 0x03, inverted)"
	depends on !TC4X7_PWM_CH17 && !TC4X7_ATOM_CH16
	select TC4X7_ATOM_ANY


config TC4X7_ATOM_CH23
	bool "/dev/pwm44 = P03.11 -> ATOM1_5 (TOUT282, sel 0x02, inverted)"
	depends on !TC4X7_PWM_CH18
	select TC4X7_ATOM_ANY

config TC4X7_ATOM_CH24
	bool "/dev/pwm45 = P03.11 -> ATOM2_5 (TOUT282, sel 0x03)"
	depends on !TC4X7_PWM_CH18 && !TC4X7_ATOM_CH23
	select TC4X7_ATOM_ANY

config TC4X7_ATOM_CH25
	bool "/dev/pwm46 = P03.12 -> ATOM1_6 (TOUT283, sel 0x11)"
	depends on !TC4X7_PWM_CH19
	select TC4X7_ATOM_ANY

config TC4X7_ATOM_CH26
	bool "/dev/pwm47 = P03.12 -> ATOM2_4 (TOUT283, sel 0x12, inverted)"
	depends on !TC4X7_PWM_CH19
	select TC4X7_ATOM_ANY

config TC4X7_ATOM_CH27
	bool "/dev/pwm48 = P03.14 -> ATOM1_7 (TOUT285, sel 0x11)"
	depends on !TC4X7_PWM_CH20
	select TC4X7_ATOM_ANY

config TC4X7_ATOM_CH28
	bool "/dev/pwm49 = P03.14 -> ATOM2_5 (TOUT285, sel 0x12, inverted)"
	depends on !TC4X7_PWM_CH20
	select TC4X7_ATOM_ANY

endmenu

endif # TC4X_EGTM_PWM_LOWERHALF

endif
```
