## arch/tricore/src/tc4xx/Kconfig
```kconfig
comment "Infineon Aurix TC4XX Family configurations"

choice
	prompt "Infineon Aurix TC4XX Chip selection"

config TC4XX_CHIP_TC4D7
	bool "TC4D7 SoC"
	---help---
		TC4D7 SoC


config TC4XX_CHIP_TC499
	bool "TC499 SoC"
	---help---
		TC499 SoC

endchoice

config ARCH_TRICORE_CPU_COUNT
	int "TRICORE CPU count"
	default 1
	---help---
		Tricore CPU count

menu "TC4XX Peripheral Support"

config TC4XX_PERI_MMAP_OFFSET
       hex "Tricore base address"
       default 0x4400000 if TC4XX_CHIP_TC4D7
       default 0 if TC4XX_CHIP_TC499

# UART
config TRICORE_UART0
        bool "ASCLIN0 UART"
        default n
        select UART0_SERIALDRIVER
        select SERIAL
        ---help---
                Enable the ASCLIN0 peripheral as a UART serial port.

if TRICORE_UART0

config TRICORE_UART0_RXIRQ
        int "ASCLIN0 RX IRQ number"
        default 172

config TRICORE_UART0_TXIRQ
        int "ASCLIN0 TX IRQ number"
        default 173

config TRICORE_UART0_ERIRQ
        int "ASCLIN0 ERR IRQ number"
        default 174

config TRICORE_ASCLINF_FREQUENCY
        int "fASCLINF clock frequency (Hz)"
        default 200000000

endif # TRICORE_UART0

config TRICORE_STM_FREQUENCY
        int "STM clock frequency (Hz)"
        default 500000000
        ---help---
                Frequency of the clock feeding the System Timer.  The tick
                period is derived from it, so a wrong value scales all
                timekeeping.

config TRICORE_UART1
        bool "ASCLIN1 UART"
        default n
        select UART1_SERIALDRIVER
        select SERIAL
        ---help---
                Enable the ASCLIN1 peripheral as a UART serial port.

                On the a3g-tc4d7-lite board ASCLIN1 maps to P15.0 (TX,
                ALT2) and P15.1 (RX, ALTI_A), exposed on the mikroBUS
                connector pins 13/14.

if TRICORE_UART1

config TRICORE_UART1_RXIRQ
        int "ASCLIN1 RX IRQ number"
        default 175

config TRICORE_UART1_TXIRQ
        int "ASCLIN1 TX IRQ number"
        default 176

config TRICORE_UART1_ERIRQ
        int "ASCLIN1 ERR IRQ number"
        default 177

endif # TRICORE_UART1

# WTU
config TC4X_WDT
	bool "TC4x Watchdog Timer (WTU)"
	default n
	depends on WATCHDOG
	select TC4X_SMU
	---help---
		Enable the TC4x Watchdog Timer driver.  Supports all 7
		WDT instances: CPU0-CPU5 and System WDT.

		WDT overflow triggers an alarm to the SMU.  The SMU must
		be configured (via CONFIG_TC4X_SMU) to issue RESET0_REQ
		for the alarm to cause a system reset.

config TC4X_WDT_FSPB
	int "SPB clock frequency (Hz)"
	default 100000000
	depends on TC4X_WDT
	---help---
		The SPB (System Peripheral Bus) clock frequency in Hz.
		Used to calculate WDT timeout periods.  Default 100 MHz.

# I2C
menuconfig TC4XX_I2C
	bool "TC4xx I2C Master Driver"
	default n
	depends on I2C
	select ARCH_HAVE_I2CRESET
	---help---
		Enable I2C master driver for Infineon Aurix TC4xx.

if TC4XX_I2C

config TC4XX_I2C_CLOCK_FREQ
	int "I2C peripheral source clock (fI2C) in Hz"
	default 100000000
	---help---
		The fI2C clock frequency from the CCU. Check your clock
		tree configuration. Default assumes 100 MHz.

config TC4XX_I2C0
	bool "Enable I2C0"
	default n

if TC4XX_I2C0

config TC4XX_I2C0_FREQUENCY
	int "I2C0 default bus frequency"
	default 100000
	---help---
		Default I2C bus speed in Hz.
		standard mode (100 kHz)
		fast mode (400 kHz)

config TC4XX_I2C0_PISEL
	int "I2C0 pin input select"
	default 1
	range 0 7
	---help---
		Selects which port pins provide SDA/SCL input signals.

endif # TC4XX_I2C0

config TC4XX_I2C1
	bool "Enable I2C1"
	default n

if TC4XX_I2C1

config TC4XX_I2C1_FREQUENCY
	int "I2C1 default bus frequency"
	default 100000

config TC4XX_I2C1_PISEL
	int "I2C1 pin input select"
	default 0
	range 0 7

endif # TC4XX_I2C1

config TC4XX_I2C2
	bool "Enable I2C2"
	default n

if TC4XX_I2C2

config TC4XX_I2C2_FREQUENCY
	int "I2C2 default bus frequency"
	default 100000

config TC4XX_I2C2_PISEL
	int "I2C2 pin input select"
	default 0
	range 0 7

endif # TC4XX_I2C2

endif # TC4XX_I2C

# GETH
menuconfig TC4XX_GETH
	bool "Infineon Tricore GETH support"
	default n
	depends on NET_DWXGMAC
	---help---
		Enable Infineon Tricore GETH support

if TC4XX_GETH

config TRICORE_GETH_BASE
    hex "Tricore GETH base address"
    default 0xf9000000

config TRICORE_GETH_BRIDGE_IRQ
    int "Tricore GETH bridge interrupt number"
    default 760

endif # TC4XX_GETH

# LETH
menuconfig TC4XX_LETH
	bool "Infineon Tricore LETH support"
	default n
	depends on NET_DWXGMAC
	---help---
		Enable Infineon Tricore Lite Ethernet (LETH) support.  LETH
		wraps the same DesignWare Ethernet-QoS MAC as GETH but drives
		an external 10/100 RMII PHY directly through the port pads.

if TC4XX_LETH

config TRICORE_LETH_BASE
    hex "Tricore LETH base address"
    default 0xf9400000

endif # TC4XX_LETH

config TC4XX_XSPI
	bool "xSPI controller"
	default n
	select XSPI
	select XSPI_DW_SSI
	select XSPI_DW_SSI_HAS_DDR
	select XSPI_DW_SSI_HAS_HYPERBUS
	select XSPI_DW_SSI_HAS_DMA
	select XSPI_DW_SSI_HAS_XIP
	---help---
		Enable the TC4xx xSPI controller. Provides SoC glue around
		the Synopsys DWC_SSI IP core driver for the single xSPI
		instance on TC4Dx devices.

if TC4XX_XSPI

config TC4XX_XSPI_SSI_CLK_HZ
	int "xSPI SSI_clk rate (Hz)"
	default 100000000
	---help---
		Input SSI_clk frequency feeding the xSPI controller. Used by
		the IP driver to compute the BAUDR divider. The default is a
		placeholder; set from the board clock tree.

config TC4XX_XSPI_PORTSEL_GPIO
	bool "Route via GPIO pads (port 20) instead of HSFAST (port 16)"
	default n
	---help---
		Select GPIO pad routing for reduced functionality mode:
		SDR only, quad max, 25 MHz max, 3 V devices only.
		Useful for early bring-up on boards that expose port 20 pins
		on headers. Clear this for production HSFAST routing.

endif # TC4XX_XSPI

endmenu

# QSPI
menuconfig TC4XX_QSPI
	bool "TC4xx QSPI master driver"
	default n
	depends on SPI
        select SPI_DRIVER
        select SPI_EXCHANGE
        ---help---
                Enable the polled-mode QSPI master driver for TC4Dx.
                Provides a NuttX spi_ops_s lower-half built on top of the
                dedicated QSPI peripheral with hardware SLSO chip selects.
                Automatically enables the SPI character driver (/dev/spiN)
                and the spi_exchange() transfer operation.

if TC4XX_QSPI

config TC4XX_QSPI_FPER_HZ
        int "fPER clock feeding the QSPI module (Hz)"
        default 200000000
        ---help---
                Peripheral PLL clock frequency driving the QSPI module.
                TC4Dx boards typically run fPER at 200 MHz via the PER PLL
                (PERCCUCON0.CLKSELQSPI=2, QSPIDIV=1).  Adjust if a different
                clock source or divider is configured in tc4x_clockconfig.c.

if TC4XX_QSPI0
config TC4XX_QSPI0_DEFAULT_CS
	int "QSPI0 default hardware CS (SLSO index)"
	default 0
	range 0 15
config TC4XX_QSPI0_MRIS
	int "QSPI0 MRIS pin input select"
	default 0
	range 0 7
config TC4XX_QSPI0_TXIRQ
	int "QSPI0 TX interrupt node index (IRQ_QSPI0_TX)"
	default 280
config TC4XX_QSPI0_RXIRQ
	int "QSPI0 RX interrupt node index (IRQ_QSPI0_RX)"
	default 281
config TC4XX_QSPI0_ERIRQ
	int "QSPI0 Error interrupt node index (IRQ_QSPI0_ERR)"
	default 282
endif # TC4XX_QSPI0

config TC4XX_QSPI1
	bool "Enable QSPI1"
	default n

if TC4XX_QSPI1
config TC4XX_QSPI1_DEFAULT_CS
	int "QSPI1 default hardware CS (SLSO index)"
	default 0
	range 0 15
config TC4XX_QSPI1_MRIS
	int "QSPI1 MRIS pin input select"
	default 0
	range 0 7
config TC4XX_QSPI1_TXIRQ
	int "QSPI1 TX interrupt node index (IRQ_QSPI1_TX)"
	default 285
config TC4XX_QSPI1_RXIRQ
	int "QSPI1 RX interrupt node index (IRQ_QSPI1_RX)"
	default 286
config TC4XX_QSPI1_ERIRQ
	int "QSPI1 Error interrupt node index (IRQ_QSPI1_ERR)"
	default 287
endif # TC4XX_QSPI1

config TC4XX_QSPI2
	bool "Enable QSPI2"
	default n

if TC4XX_QSPI2
config TC4XX_QSPI2_DEFAULT_CS
	int "QSPI2 default hardware CS (SLSO index)"
	default 0
	range 0 15
config TC4XX_QSPI2_MRIS
	int "QSPI2 MRIS pin input select"
	default 0
	range 0 7
config TC4XX_QSPI2_TXIRQ
	int "QSPI2 TX interrupt node index (IRQ_QSPI2_TX)"
	default 290
config TC4XX_QSPI2_RXIRQ
	int "QSPI2 RX interrupt node index (IRQ_QSPI2_RX)"
	default 291
config TC4XX_QSPI2_ERIRQ
	int "QSPI2 Error interrupt node index (IRQ_QSPI2_ERR)"
	default 292
endif # TC4XX_QSPI2

config TC4XX_QSPI3
	bool "Enable QSPI3"
	default n

if TC4XX_QSPI3
config TC4XX_QSPI3_DEFAULT_CS
	int "QSPI3 default hardware CS (SLSO index)"
	default 0
	range 0 15
config TC4XX_QSPI3_MRIS
	int "QSPI3 MRIS pin input select"
	default 0
	range 0 7
config TC4XX_QSPI3_TXIRQ
	int "QSPI3 TX interrupt node index (IRQ_QSPI3_TX)"
	default 295
config TC4XX_QSPI3_RXIRQ
	int "QSPI3 RX interrupt node index (IRQ_QSPI3_RX)"
	default 296
config TC4XX_QSPI3_ERIRQ
	int "QSPI3 Error interrupt node index (IRQ_QSPI3_ERR)"
	default 297
endif # TC4XX_QSPI3

config TC4XX_QSPI4
	bool "Enable QSPI4 (mikroBUS SPI header)"
	default n
	---help---
		Enable QSPI4.  On the a3g-tc4d7-lite board QSPI4 is wired
                to the SEMPER Flash / mikroBUS SPI header:
                MOSI=P22.0 (QSPI4_MTSR_F, ALT3),
                MISO=P22.1 (QSPI4_MRSTB_F, MRIS=1, input),
                SCLK=P22.3 (QSPI4_SCLK_F, ALT3),
                CS=SLSO6 (P23.1, ALT3).

if TC4XX_QSPI4
config TC4XX_QSPI4_DEFAULT_CS
        int "QSPI4 default hardware CS (SLSO index)"
        default 6
        range 0 15
config TC4XX_QSPI4_MRIS
        int "QSPI4 MRIS pin input select"
        default 1
        range 0 7
config TC4XX_QSPI4_LOOPBACK
        bool "Enable internal loopback on QSPI4"
        default n
        ---help---
                Enable GLOBALCON.LB to internally connect MTSR to MRST.
                Use this for spi_test /dev/spi1 without an external
                MOSI->MISO jumper wire.
config TC4XX_QSPI4_TXIRQ
	int "QSPI4 TX interrupt node index (IRQ_QSPI4_TX)"
	default 300
config TC4XX_QSPI4_RXIRQ
	int "QSPI4 RX interrupt node index (IRQ_QSPI4_RX)"
	default 301
config TC4XX_QSPI4_ERIRQ
	int "QSPI4 Error interrupt node index (IRQ_QSPI4_ERR)"
	default 302
endif # TC4XX_QSPI4

config TC4XX_QSPI5
	bool "Enable QSPI5"
	default n

if TC4XX_QSPI5
config TC4XX_QSPI5_DEFAULT_CS
	int "QSPI5 default hardware CS (SLSO index)"
	default 0
	range 0 15
config TC4XX_QSPI5_MRIS
	int "QSPI5 MRIS pin input select"
	default 0
	range 0 7
config TC4XX_QSPI5_TXIRQ
	int "QSPI5 TX interrupt node index (IRQ_QSPI5_TX)"
	default 305
config TC4XX_QSPI5_RXIRQ
	int "QSPI5 RX interrupt node index (IRQ_QSPI5_RX)"
	default 306
config TC4XX_QSPI5_ERIRQ
	int "QSPI5 Error interrupt node index (IRQ_QSPI5_ERR)"
	default 307
endif # TC4XX_QSPI5

config TC4XX_QSPI6
	bool "Enable QSPI6"
	default n

if TC4XX_QSPI6
config TC4XX_QSPI6_DEFAULT_CS
	int "QSPI6 default hardware CS (SLSO index)"
	default 0
	range 0 15
config TC4XX_QSPI6_MRIS
	int "QSPI6 MRIS pin input select"
	default 0
	range 0 7
config TC4XX_QSPI6_TXIRQ
	int "QSPI6 TX interrupt node index (IRQ_QSPI6_TX)"
	default 310
config TC4XX_QSPI6_RXIRQ
	int "QSPI6 RX interrupt node index (IRQ_QSPI6_RX)"
	default 311
config TC4XX_QSPI6_ERIRQ
	int "QSPI6 Error interrupt node index (IRQ_QSPI6_ERR)"
	default 312
endif # TC4XX_QSPI6

config TC4XX_QSPI7
	bool "Enable QSPI7"
	default n

if TC4XX_QSPI7
config TC4XX_QSPI7_DEFAULT_CS
	int "QSPI7 default hardware CS (SLSO index)"
	default 0
	range 0 15
config TC4XX_QSPI7_MRIS
	int "QSPI7 MRIS pin input select"
	default 0
	range 0 7
config TC4XX_QSPI7_TXIRQ
	int "QSPI7 TX interrupt node index (IRQ_QSPI7_TX)"
	default 315
config TC4XX_QSPI7_RXIRQ
	int "QSPI7 RX interrupt node index (IRQ_QSPI7_RX)"
	default 316
config TC4XX_QSPI7_ERIRQ
	int "QSPI7 Error interrupt node index (IRQ_QSPI7_ERR)"
	default 317
endif # TC4XX_QSPI7

endif # TC4XX_QSPI

# SPI
config TC4XX_ASCLIN_SPI
	bool "ASCLIN SPI master support"
	default n
	depends on SPI
	---help---
		Enable SPI master mode on ASCLIN modules.  The ASCLIN IP supports
		UART, LIN, and SPI modes.  This option enables the SPI lower-half
		driver that implements the NuttX spi_ops_s interface.

		Chip select is managed via GPIO, not the hardware ASLSO signal.
		Each bus instance requires its own ASCLIN module (separate from
		any ASCLIN used for UART console).

if TC4XX_ASCLIN_SPI

config TC4XX_ASCLIN3_SPI
	bool "ASCLIN3 as SPI bus 0 (mikroBUS pins)"
	default y
	---help---
		Use ASCLIN3 for SPI bus 0.  On a3g-tc4d7-lite this is wired to
		the mikroBUS connector SPI pins (verified against iLLD
		IfxAsclin_PinMap_TC4Dx_BGA292_COM):

		  MOSI: P15.6 (ASCLIN3.TX, ALT2)   - mikroBUS pin 6
		  MISO: P15.7 (ASCLIN3.RXA)        - mikroBUS pin 5
		  SCLK: P15.8 (ASCLIN3.SCLK, ALT6) - mikroBUS pin 4
		  CS:   P14.7 (GPIO)               - mikroBUS pin 3

		ASCLIN3 has no SLSO line on a header-accessible pin, so CS is
		driven as a plain GPIO from the SPI driver's select callback.

config TC4XX_ASCLIN3_SPI_LOOPBACK
	bool "Enable loopback on ASCLIN3 SPI"
	default n
	depends on TC4XX_ASCLIN3_SPI
	---help---
		Enable internal loopback (IOCR.LB) for ASCLIN3 SPI.  TX is
		internally connected to RX.  Useful for driver validation
		without external wiring.  Disable for real hardware use.

config TC4XX_ASCLIN_SPI_CHARDEV
	bool "Register SPI character device"
	default y
	depends on SPI_DRIVER
	---help---
		Register /dev/spiN character device via spi_register().
		Enables userspace access through standard SPI ioctls.

endif # TC4XX_ASCLIN_SPI

# eGTM
menuconfig TC4XX_EGTM_PWM
	bool "TC4XX eGTM PWM (TOM0)"
	default n
	---help---
		Enable the eGTM TOM0 PWM HAL (CLC + CMU + TOM + TGC + ICM).
		Provides the tc4xx_egtm_* C API. Select the lower-half option
		below to also expose /dev/pwmN via the NuttX standard PWM
		framework.

if TC4XX_EGTM_PWM

config TC4XX_EGTM_TOM0_CH
	int "TOM0 PWM channel (0..7)"
	default 0
	range 0 7
	---help---
		Which TOM0 channel the lower-half adapter and board bringup
		drive by default.

config TC4XX_EGTM_PWM_LOWERHALF
	bool "Register NuttX standard PWM driver (/dev/pwmN)"
	default n
	select PWM
	---help---
		Wraps the eGTM HAL behind the NuttX pwm_ops_s vtable so the
		channel is reachable via the upper-half PWM character driver
		(open("/dev/pwm0") + PWMIOC_* ioctls). The board bringup must
		call pwm_register("/dev/pwm0", tc4xx_egtm_pwm_initialize(0)).

if TC4XX_EGTM_PWM_LOWERHALF

config TC4XX_EGTM_PWM_GCLK_DEN
	int "CMU GCLK_DEN (GCLK = feGTM / DEN)"
	default 1
	range 1 16777215
	---help---
		CMU divider for GCLK. Some TC4xx silicon revisions reject
		writes to GCLK_DEN other than 1 (lock layer not yet
		identified). Leave at 1; the driver auto-selects the FXCLK
		tap per requested frequency.

endif # TC4XX_EGTM_PWM_LOWERHALF

endif # TC4XX_EGTM_PWM
```

## boards/tricore/tc3x/a2g-tc375-lite/Kconfig
```kconfig
#
# For a description of the syntax of this configuration file,
# see the file kconfig-language.txt in the NuttX tools repository.
#

if ARCH_BOARD_A2G_TC375_LITE

config BOARD_PHY_AUTONEG
	bool "Ethernet PHY autonegotiation"
	default y
	depends on TC3XX_GETH

config BOARD_CAN_TLE9251V_STB_PIN
	bool "Drive TLE9251V CAN_STB low at boot"
	default y
	depends on CAN
	---help---
		The AURIX lite Kit V2 wires the on-board TLE9251V CAN
		transceiver standby control to P20.6.  The transceiver
		boots in standby; the CPU must drive P20.6 low to enable
		normal operating mode before any frame leaves the bus.

config BOARD_USER_LED_GPIO
	bool "Register on-board user LED1 (P00.5) as /dev/gpio0"
	default n
	depends on DEV_GPIO
	---help---
		Registers Lite Kit user LED1 (P00.5, active-low) as /dev/gpio0,
		output with init level HIGH so the LED is off at boot.

endif
```
