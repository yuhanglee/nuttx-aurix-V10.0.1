## arch/tricore/Kconfig
```kconfig
#
# For a description of the syntax of this configuration file,
# see the file kconfig-language.txt in the NuttX tools repository.
#

if ARCH_TRICORE
comment "Tricore Options"

config TRICORE_TC18
	bool
	default n

choice
	prompt "AURIX SoC Family"
	default ARCH_CHIP_FAMILY_TC4X

config ARCH_CHIP_FAMILY_TC3X
	bool "AURIX Family TC3X"
	select ARCH_HAVE_IRQTRIGGER
	select ARCH_HAVE_PERF_EVENTS
	select ARCH_HAVE_POWEROFF
	select ARCH_HAVE_PERF_EVENTS_USER_ACCESS
	select ARCH_HAVE_SETJMP
	select ARCH_HAVE_RESET
	select ARCH_HAVE_TESTSET
	select ARCH_SETJMP_H
	---help---
		AURIX TC3X family (TriCore 1.6.2P).

config ARCH_CHIP_FAMILY_TC4X
	bool "AURIX Family TC4X"
	select TRICORE_TC18
	select ARCH_HAVE_IRQTRIGGER
	select ARCH_HAVE_PERF_EVENTS
	select ARCH_HAVE_PERF_EVENTS_USER_ACCESS
	select ARCH_HAVE_POWEROFF
	select ARCH_HAVE_SETJMP
	select ARCH_HAVE_RESET
	select ARCH_HAVE_TESTSET
	select ARCH_SETJMP_H
	---help---
		AURIX TC4X family (TriCore 1.8P).

endchoice

config ARCH_CHIP
	string
	default "tc3x"		if ARCH_CHIP_FAMILY_TC3X
	default "tc4x"		if ARCH_CHIP_FAMILY_TC4X

config ARCH_FAMILY
	string
	default "tc1v6"		if ARCH_CHIP_FAMILY_TC3X
	default "tc1v8"		if ARCH_CHIP_FAMILY_TC4X

choice
	prompt "Tricore Toolchain Selection"
	default TRICORE_TOOLCHAIN_GNUC

config TRICORE_TOOLCHAIN_GNUC
	bool "GNU GCC Toolchain"
	select ARCH_TOOLCHAIN_GNU
	---help---
		Build with the AURIX GNU GCC toolchain (tricore-elf-gcc).
		The toolchain binaries must be reachable on $PATH.

config TRICORE_TOOLCHAIN_LLVM
	bool "HighTec LLVM Toolchain"
	---help---
		Build with the HighTec LLVM/Clang toolchain (clang -target tricore).
		The toolchain binaries must be reachable on $PATH and a valid
		HighTec license must be reachable through $RLM_LICENSE.

endchoice

source "arch/tricore/src/aurix/Kconfig"

if ARCH_CHIP_FAMILY_TC3X
source "arch/tricore/src/tc3x/Kconfig"
endif

if ARCH_CHIP_FAMILY_TC4X
source "arch/tricore/src/tc4x/Kconfig"
endif

config TRICORE_AMP_NUM_CPUS
	int "AMP: number of application CPUs CPU 0 should release"
	default 1
	---help---
		In an Asymmetric Multi-Processing build, each per-CPU NuttX
		image is built with `-DCPU=N` and runs an independent kernel
		(CONFIG_ARCH_TRICORE_CPU_COUNT=1).  The image built with
		CPU=0 boots first; in tricore_start() it walks
		_flash_banks[1..N-1] and releases each secondary CPU from
		BOOTCON.HALT so the per-CPU images at the higher PFLASH
		bank addresses start running.

		Set to 1 (default) for plain single-CPU builds.  Set to 4
		for the standard a3g-tc4d7-lite AMP setup that brings up
		CPUs 0..3.

endif # ARCH_TRICORE
```

## arch/tricore/src/aurix/Kconfig
```kconfig
#
# For a description of the syntax of this configuration file,
# see the file kconfig-language.txt in the NuttX tools repository.
#

menu "AURIX peripheral selection"

config TRICORE_UART0
	bool "ASCLIN UART0"
	default n
	select UART0_SERIALDRIVER
	---help---
		Build the ASCLIN0 channel as a serial UART instance (ttyS0).

if TRICORE_UART0

config TRICORE_UART0_TXIRQ
	int "ASCLIN0 TX IRQ"
	default 173 if ARCH_CHIP_FAMILY_TC4X
	default 20  if ARCH_CHIP_FAMILY_TC3X
	---help---
		Service Request Node (SRN) for ASCLIN0 TX completion.
		Defaults match the canonical mapping in the AURIX Interrupt
		Router: 173 on TC4X and 20 on TC3X.

config TRICORE_UART0_RXIRQ
	int "ASCLIN0 RX IRQ"
	default 172 if ARCH_CHIP_FAMILY_TC4X
	default 21  if ARCH_CHIP_FAMILY_TC3X
	---help---
		Service Request Node (SRN) for ASCLIN0 RX events.
		Defaults: 172 on TC4X, 21 on TC3X.

config TRICORE_UART0_ERIRQ
	int "ASCLIN0 ER IRQ"
	default 174 if ARCH_CHIP_FAMILY_TC4X
	default 22  if ARCH_CHIP_FAMILY_TC3X
	---help---
		Service Request Node (SRN) for ASCLIN0 framing/parity/overrun
		errors. Defaults: 174 on TC4X, 22 on TC3X.

endif

config TRICORE_UART1
	bool "ASCLIN UART1"
	default n
	select UART1_SERIALDRIVER
	---help---
		Build the ASCLIN1 channel as a serial UART instance (ttyS1).

if TRICORE_UART1

config TRICORE_UART1_TXIRQ
	int "ASCLIN1 TX IRQ"
	default 176 if ARCH_CHIP_FAMILY_TC4X
	default 23  if ARCH_CHIP_FAMILY_TC3X
	---help---
		Service Request Node (SRN) for ASCLIN1 TX completion.
		Defaults: 176 on TC4X, 23 on TC3X.

config TRICORE_UART1_RXIRQ
	int "ASCLIN1 RX IRQ"
	default 175 if ARCH_CHIP_FAMILY_TC4X
	default 24  if ARCH_CHIP_FAMILY_TC3X
	---help---
		Service Request Node (SRN) for ASCLIN1 RX events.
		Defaults: 175 on TC4X, 24 on TC3X.

config TRICORE_UART1_ERIRQ
	int "ASCLIN1 ER IRQ"
	default 177 if ARCH_CHIP_FAMILY_TC4X
	default 25  if ARCH_CHIP_FAMILY_TC3X
	---help---
		Service Request Node (SRN) for ASCLIN1 framing/parity/overrun
		errors. Defaults: 177 on TC4X, 25 on TC3X.

endif

config TRICORE_ASCLINF_FREQUENCY
	int "ASCLIN fASCLIN clock frequency (Hz)"
	default 200000000 if ARCH_CHIP_FAMILY_TC4X
	default 200000000 if ARCH_CHIP_FAMILY_TC3X
	depends on TRICORE_UART0 || TRICORE_UART1 || TRICORE_LIN_SOCKET
	---help---
		ASCLIN baud generator source clock (fASCLIN), in Hz.

config TRICORE_ASCLIN_PRESCALER
	int "ASCLIN baud prescaler"
	default 1
	range 1 4096
	depends on TRICORE_UART0 || TRICORE_UART1
	---help---
		Prescaler applied to fASCLIN before the BRG fractional divider.

config TRICORE_ASCLIN_OVERSAMPLING
	int "ASCLIN oversampling factor"
	default 16
	range 4 16
	depends on TRICORE_UART0 || TRICORE_UART1
	---help---
		Number of fASCLIN ticks per UART bit. The Stern-Brocot baud
		generator targets this divisor; 16 is the AURIX default.

config TRICORE_ASCLIN_SAMPLEPOINT
	int "ASCLIN sample point within bit time"
	default 8
	range 1 15
	depends on TRICORE_UART0 || TRICORE_UART1
	---help---
		Oversample tick at which the receiver samples each RX bit.
		Must be smaller than ASCLIN_OVERSAMPLING.

config TRICORE_ASCLIN_MEDIAN_FILTER
	int "ASCLIN 3-tap median filter on RX (0/1)"
	default 1
	range 0 1
	depends on TRICORE_UART0 || TRICORE_UART1
	---help---
		Enable the 3-tap median filter on the RX bit slicer.  Use 1
		for noise-rejection on long cable runs, 0 to disable.

config TRICORE_ASCLIN_CLK_SRC
	int "ASCLIN clock source selector"
	default 2
	range 0 4
	depends on TRICORE_UART0 || TRICORE_UART1
	---help---
		ASCLIN CSR.CLKSEL value written to enable the module clock.
		0 = NOCLK (clock off), 2 = FASCLINF (fast ASCLIN clock,
		default for the on-board console), 4 = FASCLINS (slow ASCLIN
		clock). Values 1 and 3 are reserved.

menuconfig TRICORE_LIN_SOCKET
	bool "ASCLIN native LIN SocketCAN"
	default n
	depends on NET_CAN
	select NET_CAN_HAVE_ERRORS
	---help---
		Drive ASCLIN instances as SocketCAN native LIN master
		(commander) interfaces.  Every enabled instance registers as
		the next free "lin%d" network device, in ascending ASCLIN
		order.  ASCLIN0, ASCLIN1 and ASCLIN4 are offered.  The service
		request numbers follow from the instance index and the RX
		input select (IOCR.ALTI) is returned by the board pin hook
		board_aurix_setup_lin_pin().

if TRICORE_LIN_SOCKET

config TRICORE_LIN_PRESCALER
	int "LIN bit timing prescaler (BITCON.PRESCALER + 1)"
	default 4
	range 1 4096

config TRICORE_LIN_CLK_SRC
	int "LIN ASCLIN clock source (CSR.CLKSEL)"
	default 2
	---help---
		2 selects fASCLINF, 4 selects fASCLINS.

config TRICORE_LIN0
	bool "LIN on ASCLIN0"
	default n

config TRICORE_LIN0_BAUD
	int "ASCLIN0 LIN bit rate (bps)"
	depends on TRICORE_LIN0
	default 19200

config TRICORE_LIN1
	bool "LIN on ASCLIN1"
	default n

config TRICORE_LIN1_BAUD
	int "ASCLIN1 LIN bit rate (bps)"
	depends on TRICORE_LIN1
	default 19200

config TRICORE_LIN4
	bool "LIN on ASCLIN4"
	default n

config TRICORE_LIN4_BAUD
	int "ASCLIN4 LIN bit rate (bps)"
	depends on TRICORE_LIN4
	default 19200

endif # TRICORE_LIN_SOCKET

config TC4X_GPIO_ACCESS_GROUP
	int "TC4X port access group"
	default 0
	range 0 7
	depends on ARCH_CHIP_FAMILY_TC4X
	---help---
		Access group used to drive the per-port PORTPROT register.

config TRICORE_FLASH_MTD
	bool "AURIX HOST DFLASH MTD driver"
	default n
	depends on MTD
	---help---
		MTD lower-half driver for the AURIX HOST DFLASH(0) on TC3X and
		TC4X: sector erase, page program and read.

endmenu

# DMA
menuconfig TRICORE_DMA
	bool "Aurix SDMA controller driver"
	default n
	select DMA
	---help---
		Enable the Infineon Aurix SDMA controller (TC3xx/TC4xx), exposed
		through the generic NuttX DMA framework (include/nuttx/dma/dma.h).
		Consumers acquire a channel with DMA_GET_CHAN() and drive it via
		DMA_CONFIG()/DMA_START().  Supports memory-to-memory, single
		peripheral copy, and cyclic double-buffer transfers.

if TRICORE_DMA

config TRICORE_DMA_NCHANNELS
	int "Number of DMA channels exposed"
	default 8
	range 1 128
	---help---
		How many of the 128 hardware DMA channels are made available
		through the framework.  Channels are addressed by their absolute
		hardware number (0..N-1), so this must be larger than the highest
		channel number any consumer uses.

config TRICORE_DMA_IRQ_BASE
	int "DMA channel-0 transaction-end IRQ (SRN) number"
	default 460 if ARCH_CHIP_FAMILY_TC4X
	default 220 if ARCH_CHIP_FAMILY_TC3X
	default 0
	---help---
		Interrupt-router service-request-node index of DMA channel 0's
		transaction-end interrupt.  Channel c uses IRQ_BASE + c.  This is a
		fixed property of the interrupt-router connection table (TC37x/TC39x
		dma0 channel-0 = SRN 220; TC4xx dma0 channel-0 = SRN 460).  The driver
		is interrupt-driven and reports completion from this node; it must be
		non-zero (a build with IRQ_BASE = 0 is rejected at compile time).

config TRICORE_DMA_ERR_IRQ_BASE
	int "DMA error IRQ (SRN) number (0 = disabled)"
	default 440 if ARCH_CHIP_FAMILY_TC4X
	default 208 if ARCH_CHIP_FAMILY_TC3X
	default 0
	---help---
		Interrupt-router SRN of the DMA controller's error interrupt.  The
		handler reads ERRSR.LEC to find the faulting channel and reports the
		error to that channel's DMA callback with a negative errno.

		TC4Dx reports errors per resource partition (RP0 error = SRN 440);
		all exposed channels are assigned to RP0, so that single node covers
		them.  TC37x/TC39x reports errors per move engine (ME0/ME1); its RP0
		error node is SRN 208, and the handler scans both ME error-status
		registers.  Set to 0 to disable DMA error-interrupt handling.

endif # TRICORE_DMA
```
