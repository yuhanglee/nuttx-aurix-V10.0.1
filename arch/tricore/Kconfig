## arch/tricore/src/tc3xx/Kconfig
```kconfig
#
# For a description of the syntax of this configuration file,
# see the file kconfig-language.txt in the NuttX tools repository.
#
comment "Infineon Aurix TC3XX Family configurations"

choice
        prompt "Infineon Aurix TC3XX Chip selection"
        default TC3XX_CHIP_TC397

config TC3XX_CHIP_TC397
        bool "TC397 SoC"
        ---help---
                TC397 SoC

config TC3XX_CHIP_TC375
        bool "TC375 SoC"
        ---help---
                TC375 SoC

endchoice

config ARCH_TRICORE_CPU_COUNT
	int "TRICORE CPU count"
	default 1
	---help---
		Tricore CPU count

menu "TC3XX Peripheral Support"

# UART
config TRICORE_UART0
        bool "ASCLIN0 UART"
        default n
        select UART0_SERIALDRIVER
        select SERIAL
        ---help---
                Enable the ASCLIN0 peripheral as a UART serial port.

if TRICORE_UART0

config TRICORE_UART0_RXIRQ
        int "ASCLIN0 RX IRQ number"
        default 21

config TRICORE_UART0_TXIRQ
        int "ASCLIN0 TX IRQ number"
        default 20

config TRICORE_UART0_ERIRQ
        int "ASCLIN0 ERR IRQ number"
        default 22

config TRICORE_ASCLINF_FREQUENCY
        int "fASCLINF clock frequency (Hz)"
        default 100000000

endif # TRICORE_UART0

# I2C
menuconfig TC3XX_I2C
        bool "TC3xx I2C Master Driver"
        default n
        depends on I2C
        select ARCH_HAVE_I2CRESET
        ---help---
                Enable I2C master driver for Infineon Aurix TC3xx.

if TC3XX_I2C

config TC3XX_I2C_CLOCK_FREQ
        int "I2C peripheral source clock in Hz"
        default 100000000
        ---help---
                The I2C clock frequency from the CCU. Check your clock
                tree configuration. Default assumes 100 MHz.

config TC3XX_I2C0
        bool "Enable I2C0"
        default n

if TC3XX_I2C0

config TC3XX_I2C0_FREQUENCY
        int "I2C0 default bus frequency"
        default 100000
        ---help---
                Default I2C bus speed in Hz.
                standard mode (100 kHz)
                fast mode (400 kHz)

config TC3XX_I2C0_PISEL
        int "I2C0 pin input select"
        default 1
        range 0 7
        ---help---
                Selects which port pins provide SDA/SCL input signals.

endif # TC3XX_I2C0

config TC3XX_I2C1
        bool "Enable I2C1"
        default n

if TC3XX_I2C1

config TC3XX_I2C1_FREQUENCY
        int "I2C1 default bus frequency"
        default 100000

config TC3XX_I2C1_PISEL
        int "I2C1 pin input select"
        default 0
        range 0 7

endif # TC3XX_I2C1

config TC3XX_I2C2
        bool "Enable I2C2"
        default n

if TC3XX_I2C2

config TC3XX_I2C2_FREQUENCY
        int "I2C2 default bus frequency"
        default 100000

config TC3XX_I2C2_PISEL
        int "I2C2 pin input select"
        default 0
        range 0 7

endif # TC3XX_I2C2

endif # TC3XX_I2C

# GETH
menuconfig TC3XX_GETH
	bool "Infineon Tricore GETH support"
	default n
	depends on NET_DWXGMAC
	---help---
		Enable Infineon Tricore GETH support

if TC3XX_GETH

config TRICORE_GETH_BASE
    hex "Tricore GETH base address"
    default 0xf001f000

config TRICORE_GETH_PHY_MODE
    int "GETH PHY interface mode (GPCTL.EPR)"
    default 1
    ---help---
        PHY interface mode written to GETH_GPCTL.EPR:
        0 = MII, 1 = RGMII, 4 = RMII.

config TRICORE_GETH_GPCTL_ALTI
    hex "GETH GPCTL input alternate selects"
    default 0x1
    ---help---
        Raw value for the GETH_GPCTL input select fields (bits 21:0).
        Each GETH input signal has a 2-bit select choosing the input
        pad alternative A(0)/B(1)/C(2)/D(3); bits 1:0 select the MDIO
        input pad.  E.g. 0x1 routes MDIO from alternative B (TC397
        TFT, P12.1), 0x3 from alternative D (TC375 lite kit, P21.3).

endif # TC3XX_GETH

# QSPI (Synchronous Serial Interface) -- TC3xx hardware QSPI block
menuconfig TC3XX_QSPI
	bool "TC3xx QSPI master driver"
	default n
	depends on SPI
	---help---
		Enable the polled-mode QSPI master driver for the TC3xx (TC397)
		family.  Provides a NuttX spi_ops_s lower-half built on top of
		the dedicated QSPI peripheral with hardware SLSO chip selects.

if TC3XX_QSPI

config TC3XX_QSPI_FSPB_HZ
	int "fSPB clock feeding the QSPI module (Hz)"
	default 100000000
	---help---
		Source clock frequency that drives the QSPI peripheral.  TC397
		runs fSPB at 100 MHz by default; adjust to match your clock-tree
		configuration.

config TC3XX_QSPI2
	bool "Enable QSPI2"
	default n
	---help---
		Enable QSPI2 as a NuttX SPI bus.  On the TC397 ADAS Kit, QSPI2
		is wired to the TLF30682QVS01 PMIC via SLSO1 with MTSR=P15.6,
		MRST=P15.7, SCLK=P15.8, SLSO1=P14.2 (all ALT3).

if TC3XX_QSPI2

config TC3XX_QSPI2_DEFAULT_CS
	int "Default hardware CS (SLSO index, 0..15)"
	default 1
	range 0 15
	---help---
		Default SLSO line driven by the QSPI2 module.  TLF30682 on the
		TC397 ADAS Kit uses SLSO1.

endif # TC3XX_QSPI2

config TC3XX_QSPI3
	bool "TC3xx QSPI3 module"
	default n
	---help---
		Enable the QSPI3 module driver. On the A2G-TC397XA-3V3-TFT board
		QSPI3 is wired out via header X103 (P02.5/6/7/8) for external
		SPI peripherals.

config TC3XX_QSPI3_DEFAULT_CS
	int "TC3xx QSPI3 default SLSO index"
	depends on TC3XX_QSPI3
	range 0 15
	default 0
	---help---
		Hardware SLSO index used for the default chip select. For the
		W25Q128JV flash wired to P02.8, this is SLSO0 (= 0).

endif # TC3XX_QSPI

# WDT
config TC3XX_WDT
	bool "TC3xx Watchdog Timer driver"
	default n
	depends on WATCHDOG
	---help---
		Enable the TC3xx CPU watchdog timer driver.  Registers
		/dev/watchdog0 backed by SCU.WDTCPU0_CON0/CON1/SR.

		WDT overflow generates an alarm to the SMU.  Enable
		CONFIG_TC3XX_SMU to wire the overflow alarm to an
		application reset via tc3x_smu_initialize().

config TC3XX_WDT_FSPB
	int "SPB clock frequency (Hz) feeding the TC3xx WDT"
	default 100000000
	depends on TC3XX_WDT
	---help---
		Source clock for the WDT divider chain.  TC397 runs fSPB at
		100 MHz by default; adjust to match your clock-tree.

# GPT1 PWM
menuconfig TC3XX_GPT1_PWM
	bool "TC3xx GPT1 PWM output (T2/T3/T4)"
	default n
	depends on PWM
	---help---
		Enable the GPT1-block PWM lower-half driver.  Uses timers
		T3 (core), T2, and T4 (auxiliaries) to generate a PWM signal on
		the T3OUT alternate-function pin.  Provides /dev/pwm0.

		Frequency range depends on fSPB (100 MHz default) and the
		prescaler combination chosen at runtime.  With the widest
		prescaler (BPS1=÷32, T3I=÷128) the minimum frequency is
		approximately 0.4 Hz; the maximum with BPS1=÷4, T3I=÷1 is
		approximately 381 kHz.

if TC3XX_GPT1_PWM

config TC3XX_GPT120_BASE
	hex "GPT120 module base address"
	default 0xF0001800
	---help---
		Base address of the GPT120 peripheral. Verify against the TC3xx
		User Manual address map chapter before use.

config TC3XX_GPT1_PWM_T3_SRN
	int "GPT120 T3 overflow SRN (Service Request Node) index"
	default 186
	range 1 2047
	---help---
		NuttX IRQ number for the GPT120 T3 overflow interrupt.
		186 = IRQ_GPT120_T3 (TC37x/TC39x SRC table).

endif # TC3XX_GPT1_PWM

# GPT2 PWM
menuconfig TC3XX_GPT2_PWM
	bool "TC3xx GPT2 PWM output (T6/CAPREL)"
	default n
	depends on PWM
	---help---
		Enable the GPT2-block PWM lower-half driver.  Uses timer T6
		and the CAPREL register to generate a PWM signal on the T6OUT
		alternate-function pin.  Provides /dev/pwm1.

		Differs from GPT1: CAPREL holds only one reload value, so the
		T6 overflow ISR switches it between the high and low phase
		preloads on each overflow.

if TC3XX_GPT2_PWM

config TC3XX_GPT2_PWM_T6_SRN
	int "GPT120 T6 overflow SRN (Service Request Node) index"
	default 189
	range 1 2047
	---help---
		NuttX IRQ number for the GPT120 T6 overflow interrupt.
		189 = IRQ_GPT120_T6 (TC37x/TC39x SRC table).

endif # TC3XX_GPT2_PWM

# GPT12 Capture
menuconfig TC3XX_GPT2_CAP
        bool "TC3xx GPT2 capture (T5/CAPREL)"
        default n
        depends on CAPTURE
        ---help---
                Enable the GPT2-block capture lower-half driver.  Uses timer
                T5 and CAPREL to measure the frequency and duty cycle of a
                signal on the CAPIN input pin.  Registers /dev/capN.

                T5 runs free in Timer mode.  Three consecutive edge captures
                (rising, falling, rising) give the period and pulse width.
                Frequency and duty cycle are derived from T5 tick counts.

                CAPREL is shared with the GPT2 PWM path (TC3XX_GPT2_PWM).
                Both cannot be active simultaneously.  start() returns
                -EBUSY if T6 is already running.

if TC3XX_GPT2_CAP

config TC3XX_GPT2_CAP_CAPREL_SRN
        int "GPT2 CAPREL SRN (Service Request Node) index"
        default 184
        range 1 2047
        ---help---
                NuttX IRQ number for the GPT120 CAPREL interrupt.
                Verify the correct value for your specific TC3xx device.

config TC3XX_GPT2_CAP_T5I
        int "T5 input prescaler (T5I field, 0=div1 .. 7=div128)"
        default 4
        range 0 7
        ---help---
                Per-timer prescaler for T5.  T5 clock = fGPT / 2^T5I
                where fGPT = fSPB / 2 (50 MHz with fSPB = 100 MHz).

                T5I=4 (default): f_T5 = 3.125 MHz, min freq ~48 Hz.
                T5I=6: f_T5 ~781 kHz, min freq ~12 Hz.
                T5I=7: f_T5 ~390 kHz, min freq ~6 Hz.

config TC3XX_GPT2_CAP_CAPIN_SEL
        int "PISEL.ISCAPIN pin select (0=CAPINA, 1=CAPINB)"
        default 0
        range 0 1
        ---help---
                Selects which physical pin is routed to the CAPIN input.
                0 = CAPINA, 1 = CAPINB.
                Verify the alternate-function pin mapping for your device
                before changing this value.
config TC3XX_GPT2_CAP_T3IN
        bool "Enable T3IN capture input (/dev/cap3)"
        default n
        ---help---
                Enable the T3IN capture path using GPT2 T5/CAPREL.
                T3IN is routed to the CAPREL capture trigger by setting
                T5CON.CT3=1 in start().  T5 is the shared free-running
                timebase (same as CAPIN).

                T3IN and CAPIN share T5/CAPREL and the same SRN.  Only
                one may be active at a time; start() returns -EBUSY if
                the other channel is already running.

                TC375 Lite Kit: P02.6 = GPT120_T3INA (PISEL.IST3IN=0).

config TC3XX_GPT2_CAP_T3IN_SEL
        int "PISEL.IST3IN pin select (0=T3INA .. 3=T3IND)"
        depends on TC3XX_GPT2_CAP_T3IN
        default 0
        range 0 3
        ---help---
                Selects which physical pin is routed to the T3IN input.
                The PISEL.IST3IN field is 2 bits wide (four options):
                0 = T3INA (TC375 Lite Kit: P02.6).
                1 = T3INB.
                2 = T3INC.
                3 = T3IND.
                Verify the alternate-function pin mapping for your device
                before changing this value.
endif # TC3XX_GPT2_CAP

# GPT1 Capture (T2IN / T4IN using T3 as free-running timer)
menuconfig TC3XX_GPT1_CAP
	bool "TC3xx GPT1 capture (T2IN/T4IN via T3)"
	default n
	depends on CAPTURE
	---help---
		Enable GPT1-block capture channels using T2 and/or T4 in
		Capture Mode with T3 as the shared free-running time reference.

		T3 runs in Timer Mode.  T2 (minor=2) or T4 (minor=4) latch
		the current T3 value on each edge of their respective TxIN
		input pin.

		Three consecutive edge captures (rising, falling, rising) give
		period and pulse width.  Frequency and duty cycle are derived
		from T3 tick counts (16-bit).

		Cannot coexist with TC3XX_GPT1_PWM at runtime; start()
		returns -EBUSY if GPT1 PWM is active.

if TC3XX_GPT1_CAP

config TC3XX_GPT1_CAP_T2
	bool "Enable T2IN capture channel (/dev/cap2)"
	default n
	---help---
		Compile support for the T2IN capture path.  Call
		tc3xx_gpt12_gpt1_cap_register(2) from the board file after
		configuring the T2IN GPIO pin.

		TC375 Lite Kit: P00.7 = GPT120_T2INA.

config TC3XX_GPT1_CAP_T4
	bool "Enable T4IN capture channel (/dev/cap4)"
	default n
	---help---
		Compile support for the T4IN capture path.  Call
		tc3xx_gpt12_gpt1_cap_register(4) from the board file after
		configuring the T4IN GPIO pin.

		TC375 Lite Kit: P02.8 = GPT120_T4INA.

config TC3XX_GPT1_CAP_T2_SRN
	int "T2 capture SRN (Service Request Node) index"
	depends on TC3XX_GPT1_CAP_T2
	default 185
	range 1 2047
	---help---
		NuttX IRQ number for the GPT120 T2 capture interrupt (SR0).
		185 = IRQ_GPT120_T2 (TC37x/TC39x SRC table).

config TC3XX_GPT1_CAP_T3_SRN
	int "T3 SRN (Service Request Node) index (reserved)"
	default 186
	range 1 2047
	---help---
		NuttX IRQ number for the GPT120 T3 interrupt (SR1).
		186 = IRQ_GPT120_T3 (TC37x/TC39x SRC table).
		Reserved for future use; not attached at runtime.

config TC3XX_GPT1_CAP_T4_SRN
	int "T4 capture SRN (Service Request Node) index"
	depends on TC3XX_GPT1_CAP_T4
	default 187
	range 1 2047
	---help---
		NuttX IRQ number for the GPT120 T4 capture interrupt (SR2).
		187 = IRQ_GPT120_T4 (TC37x/TC39x SRC table).

config TC3XX_GPT1_CAP_T3I
	int "T3 additional prescaler (0=div1 .. 3=div8)"
	default 0
	range 0 3
	---help---
		Additional per-timer prescaler for T3 beyond BPS1.
		T3 frequency = (fSPB/4) / 2^(T3I+4).
		With fSPB=100 MHz:

		T3I=0 (default): f_T3=1.5625 MHz (640 ns/tick).
		T3I=1: f_T3=781.25 kHz.
		T3I=2: f_T3=390.625 kHz.
		T3I=3: f_T3=195.3125 kHz.

		NOTE: GPT1 T3I hardware field values 0b000-0b011 select
		external T3IN trigger inputs; internal prescaler starts at
		0b100.  The driver adds the required +4 offset automatically.

config TC3XX_GPT1_CAP_T2IN_SEL
	int "PISEL.IST2IN pin select (0=T2INA, 1=T2INB)"
	depends on TC3XX_GPT1_CAP_T2
	default 0
	range 0 1
	---help---
		Selects which physical pin is routed to T2IN.
		0 = T2INA (TC375 Lite Kit: P00.7).
		1 = T2INB.

config TC3XX_GPT1_CAP_T4IN_SEL
	int "PISEL.IST4IN pin select (0=T4INA .. 3=T4IND)"
	depends on TC3XX_GPT1_CAP_T4
	default 0
	range 0 3
	---help---
		Selects which physical pin is routed to T4IN.
		0=T4INA (TC375 Lite Kit: P02.8), 1=T4INB, 2=T4INC, 3=T4IND.

endif # TC3XX_GPT1_CAP

config TC3XX_SMU
	bool "TC3xx Safety Management Unit (SMU_core) driver"
	default n
	---help---
		Enable the SMU_core driver for the Infineon AURIX TC3xx family.

		When CONFIG_TC3XX_WDT is also enabled, the WDT timeout alarms
		(AG0 bits 0 and 6) are wired during tc3x_smu_initialize().
		The reaction depends on CONFIG_TC3XX_SMU_IRQ:
		  IRQ mode:  IGCS0 + SRC_SMU0 ISR + RT escalation to RESET.
		  Fallback:  SMU_REACT_RESET (hardware-autonomous, no ISR).

if TC3XX_SMU

config TC3XX_SMU_IRQ
	bool "SMU interrupt handler via SRC_SMU0 (IRQ 564)"
	default n
	---help---
		Route IGCS0 alarm reactions to SRC_SMU0 and attach an ISR.
		The ISR logs the alarm, clears the sticky bit, and calls
		SMU_RTStop to acknowledge within the Recovery Timer window.
		Matches the Zephyr smu_aurix driver pattern for TC3X
		(base->AGC.B.IGCS0 = 0x1 in smu_aurix_init).

		If the ISR misses the Recovery Timer deadline, the SMU fires
		the escalation reaction as a hardware safety net.

		When disabled, WDT alarms use SMU_REACT_RESET directly
		(hardware-autonomous - safe even if OS has crashed).


config TC3XX_SMU_DISABLE_DOUBLE_RESET_GUARD
	bool "Disable SMU double reset guard (development only)"
	default n
	---help---
		The TC3xx hardware holds the chip in permanent Application
		Reset if an SMU-induced reset occurs twice consecutively,
		preventing runaway watchdog reset loops.

		Enable this to clear the internal reset flag at every boot
		(WDTSCON1.CLRIRF) so repeated WDT resets do not lock up
		the board during development and testing.
		Do NOT enable this in production firmware.

config TC3XX_SMU_WDT_REACTION
	int "WDT alarm default reaction code"
	default 2 if TC3XX_SMU_IRQ
	default 6
	range 0 7
	---help---
		Reaction code written to all WDT alarm bits (AG8) during
		tc3x_smu_initialize().  This is the boot-time default;
		individual alarms can be reconfigured at runtime via the
		SMUIOC_CONFIGALARM ioctl.

		  0 = NONE    (no reaction -- WDT overflow silently ignored)
		  2 = IGCS0   (interrupt via SRC_SMU0, requires TC3XX_SMU_IRQ)
		  3 = IGCS1   (interrupt via SRC_SMU1, requires TC3XX_SMU_IRQ)
		  4 = IGCS2   (interrupt via SRC_SMU2, requires TC3XX_SMU_IRQ)
		  6 = RESET   (hardware-autonomous Application Reset, default
		               when TC3XX_SMU_IRQ is not set)
		  7 = CPURST  (CPU reset only)

endif # TC3XX_SMU

endmenu
```
