## boards/tricore/tc4xx/triboard-tc4x7-com/Kconfig
```kconfig
#
# For a description of the syntax of this configuration file,
# see the file kconfig-language.txt in the NuttX tools repository.
#

if ARCH_BOARD_TRIBOARD_TC4X7_COM

config ARCH_HAVE_LEDS
	bool
	default y

config BOARD_TC4X7_BUTTONS
	bool "Enable button support"
	default y
	---help---
		Enable support for the user push button on the
		AURIX TC4X7 Triboard. The software-visible button is wired
		to P33.11.

config ARCH_BUTTONS
	bool
	default y

config ARCH_IRQBUTTONS
	bool
	default y

if TC4XX_EGTM_PWM_LOWERHALF

menu "Triboard TC4x7 PWM channels to register"

config TC4X7_PWM_ANY
	bool

config TC4X7_PWM_CH0
	bool "/dev/pwm0  = P00.0  -> TOM0_0  (TOUT9,   sel 0x14)"
	select TC4X7_PWM_ANY

config TC4X7_PWM_CH1
	bool "/dev/pwm1  = P00.1  -> TOM0_1  (TOUT10,  sel 0x14)"
	select TC4X7_PWM_ANY

config TC4X7_PWM_CH2
	bool "/dev/pwm2  = P00.2  -> TOM0_2  (TOUT11,  sel 0x14)"
	select TC4X7_PWM_ANY

config TC4X7_PWM_CH3
	bool "/dev/pwm3  = P00.3  -> TOM0_3  (TOUT12,  sel 0x14)"
	select TC4X7_PWM_ANY

config TC4X7_PWM_CH4
	bool "/dev/pwm4  = P00.4  -> TOM0_11 (TOUT13,  sel 0x10)"
	select TC4X7_PWM_ANY

config TC4X7_PWM_CH5
	bool "/dev/pwm5  = P00.5  -> TOM0_12 (TOUT14,  sel 0x10)"
	select TC4X7_PWM_ANY

config TC4X7_PWM_CH6
	bool "/dev/pwm6  = P00.6  -> TOM0_13 (TOUT15,  sel 0x10)"
	select TC4X7_PWM_ANY

config TC4X7_PWM_CH7
	bool "/dev/pwm7  = P00.7  -> TOM0_14 (TOUT16,  sel 0x10)"
	select TC4X7_PWM_ANY

config TC4X7_PWM_CH8
	bool "/dev/pwm8  = P00.8  -> TOM0_15 (TOUT17,  sel 0x10)"
	select TC4X7_PWM_ANY

config TC4X7_PWM_CH9
	bool "/dev/pwm9  = P00.9  -> TOM0_9  (TOUT18,  sel 0x04)"
	select TC4X7_PWM_ANY

config TC4X7_PWM_CH10
	bool "/dev/pwm10 = P00.11 -> TOM0_10 (TOUT20,  sel 0x04)"
	select TC4X7_PWM_ANY

config TC4X7_PWM_CH11
	bool "/dev/pwm11 = P01.4  -> TOM1_8  (TOUT112, sel 0x05) [CLS1]"
	select TC4X7_PWM_ANY

config TC4X7_PWM_CH12
	bool "/dev/pwm12 = P01.5  -> TOM1_8  (TOUT113, sel 0x05) [CLS1]"
	select TC4X7_PWM_ANY

config TC4X7_PWM_CH13
	bool "/dev/pwm13 = P01.6  -> TOM1_9  (TOUT114, sel 0x05) [CLS1]"
	select TC4X7_PWM_ANY

config TC4X7_PWM_CH14
	bool "/dev/pwm14 = P01.7  -> TOM1_9  (TOUT115, sel 0x05) [CLS1]"
	select TC4X7_PWM_ANY

config TC4X7_PWM_CH15
	bool "/dev/pwm15 = P03.0  -> TOM2_8  (TOUT271, sel 0x15) [CLS2]"
	select TC4X7_PWM_ANY

config TC4X7_PWM_CH16
	bool "/dev/pwm16 = P03.2  -> TOM2_9  (TOUT273, sel 0x15) [CLS2]"
	select TC4X7_PWM_ANY

config TC4X7_PWM_CH17
	bool "/dev/pwm17 = P03.4  -> TOM2_10 (TOUT275, sel 0x15) [CLS2]"
	select TC4X7_PWM_ANY

config TC4X7_PWM_CH18
	bool "/dev/pwm18 = P03.11 -> TOM2_13 (TOUT282, sel 0x06) [CLS2]"
	select TC4X7_PWM_ANY

config TC4X7_PWM_CH19
	bool "/dev/pwm19 = P03.12 -> TOM2_14 (TOUT283, sel 0x15) [CLS2]"
	select TC4X7_PWM_ANY

config TC4X7_PWM_CH20
	bool "/dev/pwm20 = P03.14 -> TOM2_15 (TOUT285, sel 0x15) [CLS2]"
	select TC4X7_PWM_ANY

endmenu

endif # TC4XX_EGTM_PWM_LOWERHALF

endif
```

## drivers/net/dwxgmac/Kconfig
```kconfig
#
# For a description of the syntax of this configuration file,
# see the file kconfig-language.txt in the NuttX tools repository.
#
menuconfig NET_DWXGMAC
	bool "Synopsys Design Ware XGMAC support"
	default n
	---help---
		Enable designware xgmac Ethernet driver.

if NET_DWXGMAC

config DWXGMAC_NETHERNET
    int "Number of XGMAC Ethernet interfaces"
    default 1

config DWXGMAC_BASE
    hex "XGMAC MAC base address"
    default 0xf9010000

config DWXGMAC_MAC_STRIDE
    hex "Address stride between per-port MAC cores"
    default 0x0
    ---help---
        Distance between the MAC core of one Ethernet port and the next.
        Interface i uses DWXGMAC_BASE + i * this value.  Only needed when
        more than one interface is enabled (0x2000 on the Infineon GETH).

config DWXGMAC_DMA_OFFSET
    hex "Offset from the MAC base to the DMA register block"
    default 0x0
    ---help---
        On most parts the DWC Ethernet DMA registers are contiguous with the
        MAC core (offset 0).  The Infineon LETH wrapper places the shared DMA
        block far from the per-port MAC core, so this offset is added to the
        MAC base to reach the DMA registers (0xE000 for LETH).

config DWXGMAC_NUM_RX_DMA_DESCRIPTORS
    int "Number of RX DMA descriptors"
    default 8

config DWXGMAC_NUM_TX_DMA_DESCRIPTORS
    int "Number of TX DMA descriptors"
    default 8

config DWXGMAC_DMA_IRQ
    int "XGMAC DMA interrupt number"
    default 0

config NET_DWXGMAC_MDIO
	bool "XGMAC MDIO driver"
	default n
	---help---
		Enable MDIO bus for designware xgmac Ethernet driver.

config DWXGMAC_QOS
	bool "XGMAC based on QOS driver"
	default n
	---help---
		Enable QOS version of designware xgmac Ethernet driver.

config DWXGMAC_LINK_SPEED
	int "Fixed MAC link speed in Mbps (10/100/1000)"
	default 1000
	---help---
		Speed programmed into the MAC at link-up (full duplex).
		Must match what the PHY negotiates: 10, 100 or 1000.

config NET_DWXGMAC_MAC_LOOPBACK
	bool "Enable MAC-internal loopback (debug only)"
	default n
	---help---
		Sets the MAC loopback bit (MAC_RX_CONFIGURATION.LM on XGMAC,
		MAC_CONFIGURATION.LM on QOS) so the MAC loops every transmitted
		frame back into its own receive path, bypassing the MII/RMII
		PHY pads.  Use this only to isolate MAC vs. PHY/board issues.

config NET_DWXGMAC_DMA_SECTION_USE
	bool "Place DMA descriptors and RX buffers in a custom linker section"
	default n

config NET_DWXGMAC_DMA_SECTION
	string "Linker section for DMA descriptors and RX buffers"
	depends on NET_DWXGMAC_DMA_SECTION_USE
	---help---
		If non-empty, place the DMA descriptors and RX buffer pool
		into the named linker section.  Required on systems where the
		Ethernet DMA peripheral cannot access the default .bss memory
		(for example AURIX TriCore, where .bss lives in CPU-local DSPR
		but the GETH DMA only reaches LMU/system RAM).

endif #NET_DWXGMAC
```
